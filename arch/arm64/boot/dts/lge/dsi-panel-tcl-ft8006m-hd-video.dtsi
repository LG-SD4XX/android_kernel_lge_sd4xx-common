/* Copyright (c) 2013, The Linux Foundation. All rights reserved.
 *
 * This program is free software; you can redistribute it and/or modify
 * it under the terms of the GNU General Public License version 2 and
 * only version 2 as published by the Free Software Foundation.
 *
 * This program is distributed in the hope that it will be useful,
 * but WITHOUT ANY WARRANTY; without even the implied warranty of
 * MERCHANTABILITY or FITNESS FOR A PARTICULAR PURPOSE.  See the
 * GNU General Public License for more details.
 */

/*---------------------------------------------------------------------------
 * This file is autogenerated file using gcdb parser. Please do not edit it.
 * Update input XML file to add a new entry or update variable in this file
 * VERSION = "1.0"
 *---------------------------------------------------------------------------*/
&mdss_mdp {
	dsi_tcl_ft8006m_hd_video: qcom,mdss_dsi_tcl_ft8006m_hd_video {
		compatible = "qcom,mdss-dsi-panel";
		status = "ok";
		qcom,cont-splash-enabled;
		qcom,mdss-dsi-panel-name = "tcl ft8006m 720p video mode dsi panel";
		qcom,mdss-dsi-panel-controller = <&mdss_dsi0>;
		qcom,mdss-dsi-panel-type = "dsi_video_mode";
		qcom,mdss-dsi-panel-destination = "display_1";
		qcom,mdss-dsi-panel-framerate = <60>;
		qcom,mdss-pan-physical-width-dimension = <62>;
		qcom,mdss-pan-physical-height-dimension = <110>;
		qcom,mdss-dsi-virtual-channel-id = <0>;
		qcom,mdss-dsi-stream = <0>;
		qcom,mdss-dsi-panel-width = <720>;
		qcom,mdss-dsi-panel-height = <1280>;
		qcom,mdss-dsi-h-front-porch = <124>;
		qcom,mdss-dsi-h-back-porch = <56>;
		qcom,mdss-dsi-h-pulse-width = <16>;
		qcom,mdss-dsi-h-sync-skew = <0>;
		qcom,mdss-dsi-v-front-porch = <226>;
		qcom,mdss-dsi-v-back-porch = <32>;
		qcom,mdss-dsi-v-pulse-width = <8>;
		qcom,mdss-dsi-h-left-border = <0>;
		qcom,mdss-dsi-h-right-border = <0>;
		qcom,mdss-dsi-v-top-border = <0>;
		qcom,mdss-dsi-v-bottom-border = <0>;
		qcom,mdss-dsi-bpp = <24>;
		qcom,mdss-dsi-color-order = "rgb_swap_rgb";
		qcom,mdss-dsi-underflow-color = <0xff>;
		qcom,mdss-dsi-border-color = <0>;

		qcom,esd-check-enabled;
		qcom,mdss-dsi-panel-status-check-mode = "reg_read";
		qcom,mdss-dsi-panel-status-command = [06 01 00 00 00 00 02 0A 00];
		qcom,mdss-dsi-panel-status-command-state = "dsi_lp_mode";
		qcom,mdss-dsi-panel-status-read-length = <1>;
		qcom,mdss-dsi-panel-status-value = <0x9C>;

		qcom,mdss-dsi-on-command = [
			/* Sleep Out */
			05 01 00 00 78 00 01 11
			/* White Balance Adj. Setting */
			39 01 00 00 00 00 03 50 5A 18
			39 01 00 00 00 00 0E B1 00 AC 58 59 00 A8 3F E8 01 70 77 4E 03
			15 01 00 00 00 00 02 51 23
			15 01 00 00 00 00 02 8E 00
			/* Color tuning */
			15 01 00 00 00 00 02 50 5A
			39 01 00 00 00 00 03 50 5A 18
			39 01 00 00 00 00 0E 9F 5A 59 59 57 59 59 59 59 59 59 59 59 09
			39 01 00 00 00 00 03 50 5A 23
			15 01 00 00 00 00 02 86 1F
			15 01 00 00 00 00 02 87 09
			/* Display On */
			05 01 00 00 96 00 01 29
		];
		qcom,mdss-dsi-off-command = [
			05 01 00 00 14 00 01 28
			05 01 00 00 78 00 01 10
			39 01 00 00 00 00 03 50 5A 24
			15 01 00 00 00 00 02 90 A5
			39 01 00 00 00 00 03 04 5A 5A
		];
		qcom,mdss-dsi-on-command-state = "dsi_lp_mode";
		qcom,mdss-dsi-off-command-state = "dsi_hs_mode";
		qcom,mdss-dsi-h-sync-pulse = <1>;
		qcom,mdss-dsi-traffic-mode = "non_burst_sync_pulse";
		qcom,mdss-dsi-lane-map = "lane_map_0123";
		qcom,mdss-dsi-bllp-eof-power-mode;
		qcom,mdss-dsi-bllp-power-mode;
		qcom,mdss-dsi-tx-eot-append;
		qcom,suspend-ulps-enabled;
		qcom,mdss-dsi-lane-0-state;
		qcom,mdss-dsi-lane-1-state;
		qcom,mdss-dsi-lane-2-state;
		qcom,mdss-dsi-lane-3-state;
		qcom,mdss-dsi-lp11-init;	//reset during lp11
		qcom,mdss-dsi-panel-timings = [94 20 14 00 46 48 1A 24 18 03 04 00];
		qcom,mdss-dsi-t-clk-post = <0x04>;
		qcom,mdss-dsi-t-clk-pre = <0x1D>;
		qcom,mdss-dsi-bl-pmic-control-type = "bl_ctrl_wled";
		qcom,mdss-dsi-bl-min-level = <1>;
		qcom,mdss-dsi-bl-max-level = <255>;
		qcom,mdss-dsi-dma-trigger = "trigger_sw";
		qcom,mdss-dsi-mdp-trigger = "none";
		qcom,mdss-dsi-reset-sequence = <0 5>, <2 35>;

		lge,comfort-view-cmds-off = [
			/* OTP Stop Reload */
			39 01 00 00 00 00 03 50 5a 23
			/* Disable White Balance Adj. */
			15 01 00 00 00 00 02 8E 00
		];

		lge,comfort-view-cmds-step1 = [ /* 7000K */
			/* OTP Stop Reload */
			39 01 00 00 00 00 03 50 5a 23
			/* Enable White Balance Adj. */
			15 01 00 00 00 00 02 8E 7D
		];

		lge,comfort-view-cmds-step2 = [ /* 6610K */
			/* OTP Stop Reload */
			39 01 00 00 00 00 03 50 5a 23
			/* Enable White Balance Adj. */
			15 01 00 00 00 00 02 8E 75
		];

		lge,comfort-view-cmds-step3 = [ /* 6220K */
			/* OTP Stop Reload */
			39 01 00 00 00 00 03 50 5a 23
			/* Enable White Balance Adj. */
			15 01 00 00 00 00 02 8E 6D
		];

		lge,comfort-view-cmds-step4 = [ /* 5830K */
			/* OTP Stop Reload */
			39 01 00 00 00 00 03 50 5a 23
			/* Enable White Balance Adj. */
			15 01 00 00 00 00 02 8E 61
		];

		lge,comfort-view-cmds-step5 = [ /* 5440K */
			/* OTP Stop Reload */
			39 01 00 00 00 00 03 50 5a 23
			/* Enable White Balance Adj. */
			15 01 00 00 00 00 02 8E 55
		];

		lge,comfort-view-cmds-step6 = [ /* 5050K */
			/* OTP Stop Reload */
			39 01 00 00 00 00 03 50 5a 23
			/* Enable White Balance Adj. */
			15 01 00 00 00 00 02 8E 4B
		];

		lge,comfort-view-cmds-step7 = [ /* 4660K */
			/* OTP Stop Reload */
			39 01 00 00 00 00 03 50 5a 23
			/* Enable White Balance Adj. */
			15 01 00 00 00 00 02 8E 3B
		];

		lge,comfort-view-cmds-step8 = [ /* 4270K */
			/* OTP Stop Reload */
                        39 01 00 00 00 00 03 50 5a 23
			/* Enable White Balance Adj. */
			15 01 00 00 00 00 02 8E 2D
		];

		lge,comfort-view-cmds-step9 = [ /* 3880K */
			/* OTP Stop Reload */
			39 01 00 00 00 00 03 50 5a 23
			/* Enable White Balance Adj. */
			15 01 00 00 00 00 02 8E 1D
		];

		lge,comfort-view-cmds-step10 = [ /* 3500K */
			/* OTP Stop Reload */
			39 01 00 00 00 00 03 50 5a 23
			/* Enable White Balance Adj. */
			15 01 00 00 00 00 02 8E 0B
		];

		lge,comfort-view-cmds-state = "dsi_hs_mode";

		lge,blmap-size = <256>;
		lge,blmap = <   0 35 35 35 35 35 35 35 35 35			/* 0 ~ 9 */
			35 37 39 41 44 46 48 50 53 55				/* 10 ~ 19 */
			57 59 62 64 66 68 71 73 75 77				/* 20 ~ 29 */
			80 82 84 86 89 91 93 96 98 100				/* 30 ~ 39 */
			102 105 107 109 111 114 116 118 120 123			/* 40 ~ 49 */
			125 127 129 132 134 136 138 141 143 145			/* 50 ~ 59 */
			148 155 163 171 179 187 195 203 211 219			/* 60 ~ 69 */
			227 235 243 251 259 267 275 283 291 299			/* 70 ~ 79 */
			307 315 323 331 339 346 354 362 370 378			/* 80 ~ 89 */
			386 394 402 410 418 426 434 442 450 458			/* 90 ~ 99 */
			466 474 482 490 498 506 514 522 530 544			/* 100 ~ 109 */
			559 573 588 602 617 631 646 660 675 690			/* 110 ~ 119 */
			704 719 733 748 762 777 791 806 821 835			/* 120 ~ 129 */
			850 864 879 893 908 922 937 951 966 981			/* 130 ~ 139 */
			995 1010 1024 1039 1053 1068 1082 1097 1112 1126	/* 140 ~ 149 */
			1141 1155 1170 1184 1199 1213 1228 1243 1264 1286	/* 150 ~ 159 */
			1308 1330 1351 1373 1395 1417 1438 1460 1482 1504	/* 160 ~ 169 */
			1525 1547 1569 1591 1612 1634 1656 1678 1699 1721	/* 170 ~ 179 */
			1743 1765 1786 1808 1830 1852 1873 1895 1917 1939	/* 180 ~ 189 */
			1960 1982 2004 2026 2047 2069 2091 2113 2134 2156	/* 190 ~ 199 */
			2178 2200 2221 2243 2265 2287 2309 2338 2367 2397	/* 200 ~ 209 */
			2426 2456 2485 2514 2544 2573 2603 2632 2661 2691	/* 210 ~ 219 */
			2720 2750 2779 2808 2838 2867 2897 2926 2955 2985	/* 220 ~ 229 */
			3014 3044 3073 3103 3132 3161 3191 3220 3250 3279	/* 230 ~ 239 */
			3308 3338 3367 3397 3426 3455 3485 3514 3544 3573	/* 240 ~ 249 */
			3602 3632 3661 3691 3720 3750 >;			/* 250 ~ 255 */
	};
};
