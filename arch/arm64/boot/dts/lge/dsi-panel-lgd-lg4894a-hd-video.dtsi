/* Copyright (c) 2013, The Linux Foundation. All rights reserved.
 *
 * This program is free software; you can redistribute it and/or modify
 * it under the terms of the GNU General Public License version 2 and
 * only version 2 as published by the Free Software Foundation.
 *
 * This program is distributed in the hope that it will be useful,
 * but WITHOUT ANY WARRANTY; without even the implied warranty of
 * MERCHANTABILITY or FITNESS FOR A PARTICULAR PURPOSE.  See the
 * GNU General Public License for more details.
 */

/*---------------------------------------------------------------------------
 * This file is autogenerated file using gcdb parser. Please do not edit it.
 * Update input XML file to add a new entry or update variable in this file
 * VERSION = "1.0"
 *---------------------------------------------------------------------------*/
&mdss_mdp {
	dsi_lgd_lg4894a_hd_video: qcom,mdss_dsi_lgd_lg4894a_hd_video {
		compatible = "qcom,mdss-dsi-panel";
		status = "ok";
		qcom,cont-splash-enabled;
		qcom,mdss-dsi-panel-name = "lgd lg4894a 720p video mode dsi panel";
		qcom,mdss-dsi-panel-controller = <&mdss_dsi0>;
		qcom,mdss-dsi-panel-type = "dsi_video_mode";
		qcom,mdss-dsi-panel-destination = "display_1";
		qcom,mdss-dsi-force-clock-lane-hs;
		qcom,mdss-dsi-panel-framerate = <60>;
		qcom,mdss-dsi-virtual-channel-id = <0>;
        qcom,mdss-dsi-fbc-enable: <1>;
        qcom,mdss-dsi-fbc-bpp: <1>;
        qcom,mdss-dsi-pan-enable-dynamic-fps: <1>;
		qcom,mdss-dsi-stream = <0>;
		qcom,mdss-dsi-lp11-init;
		qcom,suspend-ulps-enabled;
		qcom,mdss-dsi-tx-eot-append;
		qcom,mdss-dsi-panel-width = <720>;
		qcom,mdss-dsi-panel-height = <1280>;
		qcom,mdss-dsi-h-front-porch = <12>;
		qcom,mdss-dsi-h-back-porch = <36>;
		qcom,mdss-dsi-h-pulse-width = <4>;
		qcom,mdss-dsi-h-sync-skew = <0>;
		qcom,mdss-dsi-v-front-porch = <500>;
		qcom,mdss-dsi-v-back-porch = <14>;
		qcom,mdss-dsi-v-pulse-width = <1>;
		qcom,mdss-dsi-h-left-border = <0>;
		qcom,mdss-dsi-h-right-border = <0>;
		qcom,mdss-dsi-v-top-border = <0>;
		qcom,mdss-dsi-v-bottom-border = <0>;
		qcom,mdss-pan-physical-width-dimension = < 62 >;
		qcom,mdss-pan-physical-height-dimension = < 110 >;
		qcom,mdss-dsi-bpp = <24>;
		qcom,mdss-dsi-color-order = "rgb_swap_rgb";
		qcom,mdss-dsi-underflow-color = <0xff>;
		qcom,mdss-dsi-border-color = <0>;

		qcom,mdss-dsi-on-command = [
			/* Manufacturer Command Protection */
			15 01 00 00 00 00 02 B0 AC
			/* Display Control 1 */
			39 01 00 00 00 00 05 B1 10 30 16 00
			/* Display Control 2 */
			39 01 00 00 00 00 0D B2 01 00 21 20 58 00 CF 10 1F 1F 34 34
			/* Panel Setting */
			39 01 00 00 00 00 04 B4 00 9F 00
			/* MIPI DSI Configuration */
			39 01 00 00 00 00 06 B5 42 C0 80 10 00
			/* MIPI D-PHY Configuration */
			39 01 00 00 00 00 04 B6 77 34 48
			/* Touch Control */
			39 01 00 00 00 00 0A BD D0 02 F4 01 04 04 12 20 22
			/* LFD Control */
			39 01 00 00 00 00 08 BE E0 E0 C9 C9 C8 F8 00
			/* Power Control 1 */
			39 01 00 00 00 00 07 C1 01 E8 D8 C2 C1 00
			/* Power Control 2 */
			39 01 00 00 00 00 04 C2 3B 13 13
			/* Power Control 3 */
			39 01 00 00 00 00 07 C3 15 2F 2F 00 66 3E
			/* Power Control 4 */
			39 01 00 00 00 00 04 C4 51 00 3C
			/* Power Control 5 */
			39 01 00 00 00 00 06 C5 25 21 20 15 15
			/* Temp Control */
			39 01 00 00 00 00 0D C7 10 22 00 28 00 62 62 62 00 B1 01 00
			/* Power Sequence Option Configuration */
			39 01 00 00 00 00 05 C8 01 00 03 8C
			/* Power Control for Touch */
			39 01 00 00 00 00 0F CC 80 20 11 26 21 24 02 62 62 62 00 B1 01 00
			/* Positive Gamma Curve for Red */
			39 01 00 00 00 00 0D D0 20 77 73 53 23 01 00 00 0F 63 76 03
			/* Negative Gamma Curve for Red */
			39 01 00 00 00 00 0D D1 20 77 73 53 23 01 00 00 0B 63 76 03
			/* Positive Gamma Curve for Green */
			39 01 00 00 00 00 0D D2 20 77 73 53 23 01 00 00 0F 63 76 03
			/* Negative Gamma Curve for Green */
			39 01 00 00 00 00 0D D3 20 77 73 53 23 01 00 00 0B 63 76 03
			/* Positive Gamma Curve for Blue */
			39 01 00 00 00 00 0D D4 20 77 73 53 23 01 00 00 11 63 76 03
			/* Negative Gamma Curve for Blue */
			39 01 00 00 00 00 0D D5 20 77 73 53 23 01 00 00 0D 63 76 03
			/* GIP Pad Setting 1 */
			39 01 00 00 00 00 16 E4 2F C3 2F 60 41 C5 C6 CC CC CB 2F CB CA CA C9 C9 C7 C8 2F 41 2F
			/* GIP Pad Setting 2 */
			39 01 00 00 0A 00 0D E5 FF FF FF FF FF 13 EF FF FF FF FF 03
			/* Color tuning */
			15 01 00 00 00 00 02 ED 40
			39 01 00 00 00 00 06 F1 00 4F 90 D0 FF
			/* Sleep Out */
			05 01 00 00 64 00 01 11
			/* Display On */
			05 01 00 00 00 00 01 29
		];
        qcom,mdss-dsi-post-panel-on-command = [
			/* Display On */
			05 01 00 00 00 00 01 29
        ];
		qcom,mdss-dsi-off-command = [
			/* Display Off */
			05 01 00 00 64 00 01 28
			/* Sleep In */
			05 01 00 00 78 00 01 10
        ];
        qcom,mdss-dsi-post-panel-on-command = [
			/* Display Off */
			05 01 00 00 64 00 01 28        
		];
		qcom,mdss-dsi-on-command-state = "dsi_lp_mode";
        qcom,mdss-dsi-post-panel-on-command-state = "dsi_lp_mode"
		qcom,mdss-dsi-off-command-state = "dsi_hs_mode";
		qcom,mdss-dsi-h-sync-pulse = <0>;
		qcom,mdss-dsi-traffic-mode = "non_burst_sync_event";
        qcom,mdss-tear-check-frame-rate: <6000>;
		qcom,mdss-dsi-lane-map = "lane_map_0123";
		qcom,mdss-dsi-bllp-eof-power-mode;
		qcom,mdss-dsi-bllp-power-mode;
		qcom,mdss-dsi-lane-0-state;
		qcom,mdss-dsi-lane-1-state;
		qcom,mdss-dsi-lane-2-state;
		qcom,mdss-dsi-lane-3-state;
		qcom,mdss-dsi-panel-timings = [8B 1E 14 00 44 4A 18 22 19 03 04 00];
		qcom,mdss-dsi-t-clk-post = <0x04>;
		qcom,mdss-dsi-t-clk-pre = <0x1C>;
		qcom,mdss-dsi-bl-min-level = <1>;
		qcom,mdss-dsi-bl-max-level = <255>;
		qcom,mdss-dsi-dma-trigger = "trigger_sw";
		qcom,mdss-dsi-mdp-trigger = "trigger_sw";
		qcom,mdss-dsi-bl-pmic-control-type = "bl_ctrl_wled";
		qcom,mdss-dsi-reset-sequence = <1 0>, <0 1>, <1 5>;
		lge,mdss-dsi-extra-command-names = "touch-osc-on", "touch-osc-off";
		lge,mdss-dsi-extra-command-touch-osc-on = [
			15 01 00 00 01 00 02 BF 20
			15 01 00 00 01 00 02 BF 60
		];
		lge,mdss-dsi-extra-command-touch-osc-off = [
			15 01 00 00 01 00 02 BF 20
			15 01 00 00 01 00 02 BF 00
		];
		lge,mdss-dsi-extra-command-state-touch-osc-on = "dsi_lp_mode";
		lge,mdss-dsi-extra-command-state-touch-osc-off = "dsi_lp_mode";

		lge,comfort-view-cmds-off = [
			15 01 00 00 00 00 02 55 00
			15 01 00 00 00 00 02 ED 00
		];

		lge,comfort-view-cmds-step1 = [ /* 7000K */
			/* Image Enhancement Enable */
			15 01 00 00 00 00 02 55 80
			/* Gamma Correction Mode Enable */
			15 01 00 00 00 00 02 ED 04
			/* Gamma Correction */
			39 01 00 00 00 00 11 F5 3C 3C 3C 3C 3C 3C 3C 3C 00 00 00 00 00 00 00 00
			39 01 00 00 00 00 11 F6 38 38 38 38 38 38 38 38 00 00 00 00 00 00 00 00
			39 01 00 00 00 00 11 F7 39 39 39 39 39 39 39 39 00 00 00 00 00 00 00 00
		];

		lge,comfort-view-cmds-step2 = [ /* 6600K */
			/* Image Enhancement Enable */
			15 01 00 00 00 00 02 55 80
			/* Gamma Correction Mode Enable */
			15 01 00 00 00 00 02 ED 04
			/* Gamma Correction */
			39 01 00 00 00 00 11 F5 3E 3E 3E 3E 3E 3E 3E 3E 00 00 00 00 00 00 00 00
			39 01 00 00 00 00 11 F6 38 38 38 38 38 38 38 38 00 00 00 00 00 00 00 00
			39 01 00 00 00 00 11 F7 38 38 38 38 38 38 38 38 00 00 00 00 00 00 00 00
		];

		lge,comfort-view-cmds-step3 = [ /* 6200K */
			/* Image Enhancement Enable */
			15 01 00 00 00 00 02 55 80
			/* Gamma Correction Mode Enable */
			15 01 00 00 00 00 02 ED 04
			/* Gamma Correction */
			39 01 00 00 00 00 11 F5 3F 3F 3F 3F 3F 3F 3F 3F 00 00 00 00 00 00 00 00
			39 01 00 00 00 00 11 F6 39 39 39 39 39 39 39 39 00 00 00 00 00 00 00 00
			39 01 00 00 00 00 11 F7 38 38 38 38 38 38 38 38 00 00 00 00 00 00 00 00
		];

		lge,comfort-view-cmds-step4 = [ /* 5800K */
			/* Image Enhancement Enable */
			15 01 00 00 00 00 02 55 80
			/* Gamma Correction Mode Enable */
			15 01 00 00 00 00 02 ED 04
			/* Gamma Correction */
			39 01 00 00 00 00 11 F5 3F 3F 3F 3F 3F 3F 3F 3F 00 00 00 00 00 00 00 00
			39 01 00 00 00 00 11 F6 39 39 39 39 39 39 39 39 00 00 00 00 00 00 00 00
			39 01 00 00 00 00 11 F7 35 35 35 35 35 35 35 35 00 00 00 00 00 00 00 00
		];

		lge,comfort-view-cmds-step5 = [ /* 5400K */
			/* Image Enhancement Enable */
			15 01 00 00 00 00 02 55 80
			/* Gamma Correction Mode Enable */
			15 01 00 00 00 00 02 ED 04
			/* Gamma Correction */
			39 01 00 00 00 00 11 F5 3F 3F 3F 3F 3F 3F 3F 3F 00 00 00 00 00 00 00 00
			39 01 00 00 00 00 11 F6 38 38 38 38 38 38 38 38 00 00 00 00 00 00 00 00
			39 01 00 00 00 00 11 F7 32 32 32 32 32 32 32 32 00 00 00 00 00 00 00 00
		];

		lge,comfort-view-cmds-step6 = [ /* 5000K */
			/* Image Enhancement Enable */
			15 01 00 00 00 00 02 55 80
			/* Gamma Correction Mode Enable */
			15 01 00 00 00 00 02 ED 04
			/* Gamma Correction */
			39 01 00 00 00 00 11 F5 3F 3F 3F 3F 3F 3F 3F 3F 00 00 00 00 00 00 00 00
			39 01 00 00 00 00 11 F6 37 37 37 37 37 37 37 37 00 00 00 00 00 00 00 00
			39 01 00 00 00 00 11 F7 2E 2E 2E 2E 2E 2E 2E 2E 00 00 00 00 00 00 00 00
		];

		lge,comfort-view-cmds-step7 = [ /* 4600K */
			/* Image Enhancement Enable */
			15 01 00 00 00 00 02 55 80
			/* Gamma Correction Mode Enable */
			15 01 00 00 00 00 02 ED 04
			/* Gamma Correction */
			39 01 00 00 00 00 11 F5 3F 3F 3F 3F 3F 3F 3F 3F 00 00 00 00 00 00 00 00
			39 01 00 00 00 00 11 F6 35 35 35 35 35 35 35 35 00 00 00 00 00 00 00 00
			39 01 00 00 00 00 11 F7 29 29 29 29 29 29 29 29 00 00 00 00 00 00 00 00
		];

		lge,comfort-view-cmds-step8 = [ /* 4200K */
			/* Image Enhancement Enable */
			15 01 00 00 00 00 02 55 80
			/* Gamma Correction Mode Enable */
			15 01 00 00 00 00 02 ED 04
			/* Gamma Correction */
			39 01 00 00 00 00 11 F5 3F 3F 3F 3F 3F 3F 3F 3F 00 00 00 00 00 00 00 00
			39 01 00 00 00 00 11 F6 35 35 35 35 35 35 35 35 00 00 00 00 00 00 00 00
			39 01 00 00 00 00 11 F7 25 25 25 25 25 25 25 25 00 00 00 00 00 00 00 00
		];

		lge,comfort-view-cmds-step9 = [ /* 3800K */
			/* Image Enhancement Enable */
			15 01 00 00 00 00 02 55 80
			/* Gamma Correction Mode Enable */
			15 01 00 00 00 00 02 ED 04
			/* Gamma Correction */
			39 01 00 00 00 00 11 F5 3F 3F 3F 3F 3F 3F 3F 3F 00 00 00 00 00 00 00 00
			39 01 00 00 00 00 11 F6 33 33 33 33 33 33 33 33 00 00 00 00 00 00 00 00
			39 01 00 00 00 00 11 F7 20 20 20 20 20 20 20 20 00 00 00 00 00 00 00 00
		];

		lge,comfort-view-cmds-step10 = [ /* 3500K */
			/* Image Enhancement Enable */
			15 01 00 00 00 00 02 55 80
			/* Gamma Correction Mode Enable */
			15 01 00 00 00 00 02 ED 04
			/* Gamma Correction */
			39 01 00 00 00 00 11 F5 3F 3F 3F 3F 3F 3F 3F 3F 00 00 00 00 00 00 00 00
			39 01 00 00 00 00 11 F6 31 31 31 31 31 31 31 31 00 00 00 00 00 00 00 00
			39 01 00 00 00 00 11 F7 1A 1A 1A 1A 1A 1A 1A 1A 00 00 00 00 00 00 00 00
		];

		lge,comfort-view-cmds-state = "dsi_hs_mode";

		lge,pre-bl-on-delay = <40>;
		lge,blmap-size = <256>;
		lge,blmap = <
		0 31 31 31 31 31 31 31 31 31
		31 33 35 38 40 43 45 48 50 53
		55 57 59 61 63 66 68 70 72 75
		78 80 82 84 86 89 91 93 95 98
		100 102 104 106 108 111 113 115 117 120
		121 123 125 127 129 131 133 135 137 139
		141 143 145 147 153 159 165 170 176 182
		188 194 200 205 211 217 223 229 235 240
		246 252 258 264 270 277 285 293 301 309
		317 325 333 340 348 356 364 372 380 388
		396 404 411 419 427 435 443 451 459 467
		475 486 498 510 522 534 546 558 570 582
		594 606 618 630 642 654 666 678 690 702
		714 726 738 750 765 780 795 810 825 840
		855 870 885 900 915 930 945 960 975 990
		1005 1020 1035 1050 1065 1080 1095 1110 1127 1144
		1161 1178 1195 1212 1229 1246 1263 1280 1298 1316
		1334 1352 1370 1388 1406 1424 1442 1460 1478 1496
		1514 1532 1550 1577 1604 1631 1659 1686 1713 1740
		1768 1795 1822 1850 1863 1876 1890 1909 1928 1947
		1966 1985 2004 2023 2042 2061 2080 2100 2121 2142
		2162 2183 2204 2225 2245 2266 2287 2307 2328 2349
		2370 2396 2423 2450 2476 2503 2530 2556 2583 2610
		2636 2663 2690 2720 2751 2782 2813 2844 2875 2906
		2936 2967 2998 3029 3060 3091 3122 3153 3183 3214
		3245 3276 3307 3338 3369 3400
		>;
	};
};
