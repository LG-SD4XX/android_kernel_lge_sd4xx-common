/*
 * Copyright (c) 2016, The Linux Foundation. All rights reserved.
 *
 * This program is free software; you can redistribute it and/or modify
 * it under the terms of the GNU General Public License version 2 and
 * only version 2 as published by the Free Software Foundation.
 *
 * This program is distributed in the hope that it will be useful,
 * but WITHOUT ANY WARRANTY; without even the implied warranty of
 * MERCHANTABILITY or FITNESS FOR A PARTICULAR PURPOSE.  See the
 * GNU General Public License for more details.
 */

&i2c_3 { /* BLSP1 QUP3 */
	qcom,clk-freq-out = <400000>;

	lg4894@28 {
		compatible = "lge,lg4894";
		status = "okay";

		reg = <0x28>;

		/* GPIOs */
		interrupt-parent = <&tlmm>;
		interrupts = <65 0x2002>;

		/* IRQF_ONESHOT		0x00002000 */
		/* IRQF_TRIGGER_FALLING		0x00000002 */
		/* IRQF_NO_SUSPEND		0x00004000 */

		pinctrl-names = "touch_pin_active","touch_pin_sleep";	/*Touch GPIO pin name setting*/
		pinctrl-0 = <&ts_int_active &ts_reset_active>;		/*Touch GPIO pin active setting*/
		pinctrl-1 = <&ts_int_suspend &ts_reset_suspend>;	/*Touch GPIO pin suspend setting*/

		reset-gpio = <&tlmm 64 0x0>;
		irq-gpio = <&tlmm 65 0x2002>;
		irqflags = <0x2002>;

		//vdd-gpio = <&tlmm 3 0x0>;  /* ???? 3 : ph2 3.3v/l5 mipi 1.2v */
		//vio-gpio = <&tlmm 63 0x0>; /* ???? 63 : 1.8v io*/

		/* Caps */
		max_x = <720>;
		max_y = <1280>;
		max_pressure = <0xff>;
		max_width_major = <15>;
		max_width_minor = <15>;
		max_orientation = <1>;
		max_id = <10>;

		/* role */
		hw_reset_delay = <210>;
		sw_reset_delay = <90>;
		use_lpwg = <1>;
		use_lpwg_test = <1>;
		hide_coordinate = <1>;

		/* firmware */
		use_fw_upgrade = <0>;

		fw_image = "touch/cv3/siw/T0W53CV3_1_16.img",
					"touch/cv3/siw/L0W53CV3_1_09.img";
		panel_spec = "touch/cv3/siw/cv3_limit.txt";
		panel_spec_mfts_folder = "touch/cv3/siw/cv3_limit_mfts.txt";
	};
};
