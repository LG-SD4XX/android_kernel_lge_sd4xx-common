/* Copyright (c) 2013, The Linux Foundation. All rights reserved.
 *
 * This program is free software; you can redistribute it and/or modify
 * it under the terms of the GNU General Public License version 2 and
 * only version 2 as published by the Free Software Foundation.
 *
 * This program is distributed in the hope that it will be useful,
 * but WITHOUT ANY WARRANTY; without even the implied warranty of
 * MERCHANTABILITY or FITNESS FOR A PARTICULAR PURPOSE.  See the
 * GNU General Public License for more details.
 */

/*---------------------------------------------------------------------------
 * This file is autogenerated file using gcdb parser. Please do not edit it.
 * Update input XML file to add a new entry or update variable in this file
 * VERSION = "1.0"
 *---------------------------------------------------------------------------*/
&mdss_mdp {
	dsi_cv3_lgd_lg4894_hd_video: qcom,mdss_dsi_cv3_lgd_lg4894_hd_video {
		compatible = "qcom,mdss-dsi-panel";
		status = "ok";
		qcom,cont-splash-enabled;
		qcom,mdss-dsi-panel-name = "LGD LG4894 HD video mode dsi panel";
		qcom,mdss-dsi-panel-controller = <&mdss_dsi0>;
		qcom,mdss-dsi-panel-type = "dsi_video_mode";
		qcom,mdss-dsi-panel-destination = "display_1";
		qcom,mdss-dsi-force-clock-lane-hs;
		qcom,mdss-dsi-panel-framerate = <60>;
		qcom,mdss-dsi-virtual-channel-id = <0>;
		qcom,mdss-dsi-stream = <0>;
		qcom,mdss-dsi-lp11-init;
		qcom,suspend-ulps-enabled;

		qcom,esd-check-enabled;
		qcom,mdss-dsi-panel-status-check-mode = "reg_read";
		qcom,mdss-dsi-panel-status-command = [06 01 00 00 00 00 02 0A 00];
		qcom,mdss-dsi-panel-status-command-state = "dsi_lp_mode";
		qcom,mdss-dsi-panel-status-read-length = <1>;
		qcom,mdss-dsi-panel-status-value = <0x9C>;

		qcom,mdss-dsi-tx-eot-append;
		qcom,mdss-dsi-panel-width = <720>;
		qcom,mdss-dsi-panel-height = <1280>;
		qcom,mdss-dsi-h-front-porch = <28>;
		qcom,mdss-dsi-h-back-porch = <36>;
		qcom,mdss-dsi-h-pulse-width = <4>;
		qcom,mdss-dsi-h-sync-skew = <0>;
		qcom,mdss-dsi-v-back-porch = <14>;
		qcom,mdss-dsi-v-front-porch = <500>;
		qcom,mdss-dsi-v-pulse-width = <1>;
		qcom,mdss-dsi-h-left-border = <0>;
		qcom,mdss-dsi-h-right-border = <0>;
		qcom,mdss-dsi-v-top-border = <0>;
		qcom,mdss-dsi-v-bottom-border = <0>;
		qcom,mdss-pan-physical-width-dimension = < 66 >; // 65.98mm
		qcom,mdss-pan-physical-height-dimension = < 117 >; // 117.31 mm
		qcom,mdss-dsi-bpp = <24>;
		qcom,mdss-dsi-color-order = "rgb_swap_rgb";
		qcom,mdss-dsi-underflow-color = <0xff>;
		qcom,mdss-dsi-border-color = <0>;
		qcom,mdss-dsi-on-command = [
			/* Manufacturer Command Protection */
			15 01 00 00 00 00 02 B0 AC
			/* Display Control 1 */
			39 01 00 00 00 00 05 B1 10 30 16 00
			/* Display Control 2 */
			39 01 00 00 00 00 0D B2 01 00 21 20 58 00 CF 10 0F 1F 34 00
			/* Panel Setting */
			39 01 00 00 00 00 04 B4 00 9F 00
			/* MIPI DSI Configuration */
			39 01 00 00 00 00 06 B5 42 C0 80 10 00
			/* MIPI D-PHY Configuration */
			39 01 00 00 00 00 04 B6 77 34 48
			/* Touch Control */
			39 01 00 00 00 00 0A BD D0 02 F4 01 04 04 12 20 22
			/* LFD Control */
			39 01 00 00 00 00 08 BE E0 E0 C9 C9 C8 F8 00
			/* Power Control 1 */
			39 01 00 00 00 00 07 C1 01 E8 D8 C2 C1 00
			/* Power Control 2 */
			39 01 00 00 00 00 04 C2 3B 13 13
			/* Power Control 3 */
			39 01 00 00 00 00 07 C3 15 2F 2F 00 66 3E
			/* Power Control 4 */
			39 01 00 00 00 00 04 C4 51 00 3C
			/* Power Control 5 */
			39 01 00 00 00 00 06 C5 25 20 20 16 16
			/* Temp Control */
			39 01 00 00 00 00 0D C7 10 22 00 28 00 62 62 62 00 B1 01 00
			/* Power Sequence Option Configuration */
			39 01 00 00 00 00 05 C8 01 00 03 8C
			/* Power Control for Touch */
			39 01 00 00 00 00 0F CC 22 2F 11 26 21 24 02 62 62 62 00 B1 01 00
			/* Positive Gamma Curve for Red */
			39 01 00 00 00 00 0D D0 60 45 23 53 23 41 00 00 00 76 56 03
			/* Negative Gamma Curve for Red */
			39 01 00 00 00 00 0D D1 60 45 23 53 23 41 00 00 00 76 56 03
			/* Positive Gamma Curve for Green */
			39 01 00 00 00 00 0D D2 60 45 23 53 23 41 00 00 00 76 56 03
			/* Negative Gamma Curve for Green */
			39 01 00 00 00 00 0D D3 60 45 23 53 23 41 00 00 00 76 56 03
			/* Positive Gamma Curve for Blue */
			39 01 00 00 00 00 0D D4 60 45 23 53 23 61 0F 0F 00 65 56 03
			/* Negative Gamma Curve for Blue */
			39 01 00 00 00 00 0D D5 60 45 23 53 23 61 0F 0F 00 65 56 03
			/* GIP Pad Setting 1 */
			39 01 00 00 00 00 16 E4 2F C3 2F 60 41 C5 C6 CC CC CB 2F CB CA CA C9 C9 C7 C8 2F 41 2F
			/* GIP Pad Setting 2 */
			39 01 00 00 00 00 0D E5 FF FF FF FF FF 13 EF FF FF FF FF 03
			/*MIE*/
			15 01 00 00 00 00 02 55 80
			15 01 00 00 00 00 02 ED 50
			39 01 00 00 00 00 06 F1 00 4A 95 E8 FF
			39 01 00 00 00 00 07 F2 85 00 40 80 C0 FF
			/* Sleep Out */
			05 01 00 00 64 00 01 11
			/* Display On */
			05 01 00 00 00 00 01 29
		];
		qcom,mdss-dsi-off-command = [
			/* Display Off */
			05 01 00 00 64 00 01 28
			/* Sleep In */
			05 01 00 00 78 00 01 10
		];

		lge,comfort-view-cmds-off = [		// NORMAL
			15 01 00 00 00 00 02 55 80
			15 01 00 00 00 00 02 ED 50
		];

		lge,comfort-view-cmds-step1 = [ /* 7000K */
			15 01 00 00 00 00 02 55 80
			15 01 00 00 00 00 02 ED 54
			39 01 00 00 00 00 11 F5 3C 3C 3C 3C 3C 3C 3C 3C 00 00 00 00 00 00 00 00
			39 01 00 00 00 00 11 F6 40 40 40 40 40 40 40 40 00 00 00 00 00 00 00 00
			39 01 00 00 00 00 11 F7 38 38 38 38 38 38 38 38 00 00 00 00 00 00 00 00
		];
		lge,comfort-view-cmds-step2 = [ /* 6500K */
			15 01 00 00 00 00 02 55 80
			15 01 00 00 00 00 02 ED 54
			39 01 00 00 00 00 11 F5 3C 3C 3C 3C 3C 3C 3C 3C 00 00 00 00 00 00 00 00
			39 01 00 00 00 00 11 F6 40 40 40 40 40 40 40 40 00 00 00 00 00 00 00 00
			39 01 00 00 00 00 11 F7 35 35 35 35 35 35 35 35 00 00 00 00 00 00 00 00
		];
		lge,comfort-view-cmds-step3 = [ /* 6000K */
			15 01 00 00 00 00 02 55 80
			15 01 00 00 00 00 02 ED 54
			39 01 00 00 00 00 11 F5 3C 3C 3C 3C 3C 3C 3C 3C 00 00 00 00 00 00 00 00
			39 01 00 00 00 00 11 F6 40 40 40 40 40 40 40 40 00 00 00 00 00 00 00 00
			39 01 00 00 00 00 11 F7 32 32 32 32 32 32 32 32 00 00 00 00 00 00 00 00
		];

		lge,comfort-view-cmds-step4 = [ /* 5500K */
			15 01 00 00 00 00 02 55 80
			15 01 00 00 00 00 02 ED 54
			39 01 00 00 00 00 11 F5 3A 3A 3A 3A 3A 3A 3A 3A 00 00 00 00 00 00 00 00
			39 01 00 00 00 00 11 F6 40 40 40 40 40 40 40 40 00 00 00 00 00 00 00 00
			39 01 00 00 00 00 11 F7 29 29 29 29 29 29 29 29 00 00 00 00 00 00 00 00
		];
		lge,comfort-view-cmds-step5 = [ /* 5000K */
			15 01 00 00 00 00 02 55 80
			15 01 00 00 00 00 02 ED 54
			39 01 00 00 00 00 11 F5 3E 3E 3E 3E 3E 3E 3E 3E 00 00 00 00 00 00 00 00
			39 01 00 00 00 00 11 F6 40 40 40 40 40 40 40 40 00 00 00 00 00 00 00 00
			39 01 00 00 00 00 11 F7 25 25 25 25 25 25 25 25 00 00 00 00 00 00 00 00
		];
		lge,comfort-view-cmds-step6 = [ /* 4500K */
			15 01 00 00 00 00 02 55 80
			15 01 00 00 00 00 02 ED 54
			39 01 00 00 00 00 11 F5 40 40 40 40 40 40 40 40 00 00 00 00 00 00 00 00
			39 01 00 00 00 00 11 F6 40 40 40 40 40 40 40 40 00 00 00 00 00 00 00 00
			39 01 00 00 00 00 11 F7 20 20 20 20 20 20 20 20 00 00 00 00 00 00 00 00
		];
		lge,comfort-view-cmds-step7 = [ /* 4000K */
			15 01 00 00 00 00 02 55 80
			15 01 00 00 00 00 02 ED 54
			39 01 00 00 00 00 11 F5 40 40 40 40 40 40 40 40 00 00 00 00 00 00 00 00
			39 01 00 00 00 00 11 F6 3B 3B 3B 3B 3B 3B 3B 3B 00 00 00 00 00 00 00 00
			39 01 00 00 00 00 11 F7 1A 1A 1A 1A 1A 1A 1A 1A 00 00 00 00 00 00 00 00
		];
		lge,comfort-view-cmds-step8 = [ /* 3500K */
			15 01 00 00 00 00 02 55 80
			15 01 00 00 00 00 02 ED 54
			39 01 00 00 00 00 11 F5 40 40 40 40 40 40 40 40 00 00 00 00 00 00 00 00
			39 01 00 00 00 00 11 F6 38 38 38 38 38 38 38 38 00 00 00 00 00 00 00 00
			39 01 00 00 00 00 11 F7 10 10 10 10 10 10 10 10 00 00 00 00 00 00 00 00
		];
		lge,comfort-view-cmds-step9 = [ /* 3000K */
			15 01 00 00 00 00 02 55 80
			15 01 00 00 00 00 02 ED 54
			39 01 00 00 00 00 11 F5 40 40 40 40 40 40 40 40 00 00 00 00 00 00 00 00
			39 01 00 00 00 00 11 F6 32 32 32 32 32 32 32 32 00 00 00 00 00 00 00 00
			39 01 00 00 00 00 11 F7 00 00 00 00 00 00 00 00 00 00 00 00 00 00 00 00
		];

		lge,comfort-view-cmds-step10 = [ /* 2500K */
			15 01 00 00 00 00 02 55 80
			15 01 00 00 00 00 02 ED 54
			39 01 00 00 00 00 11 F5 40 40 40 40 40 40 40 40 00 00 00 00 00 00 00 00
			39 01 00 00 00 00 11 F6 28 28 28 28 28 28 28 28 00 00 00 00 00 00 00 00
			39 01 00 00 00 00 11 F7 00 00 00 00 00 00 00 00 00 00 00 00 00 00 00 00
		];

		lge,comfort-view-cmds-state = "dsi_hs_mode";

		qcom,mdss-dsi-on-command-state = "dsi_lp_mode";
		qcom,mdss-dsi-off-command-state = "dsi_hs_mode";
		qcom,mdss-dsi-reader-mode-command-state = "dsi_hs_mode";
		qcom,mdss-dsi-h-sync-pulse = <0>;
		qcom,mdss-dsi-traffic-mode = "non_burst_sync_event";
		qcom,mdss-dsi-lane-map = "lane_map_0123";
		qcom,mdss-dsi-bllp-eof-power-mode;
		qcom,mdss-dsi-bllp-power-mode;
		qcom,mdss-dsi-last-line-interleave;
		qcom,mdss-dsi-lane-0-state;
		qcom,mdss-dsi-lane-1-state;
		qcom,mdss-dsi-lane-2-state;
		qcom,mdss-dsi-lane-3-state;
		qcom,mdss-dsi-panel-timings = [94 20 14 00 46 48 1A 24 18 03 04 00];
		qcom,mdss-dsi-t-clk-post = <0x04>;
		qcom,mdss-dsi-t-clk-pre = <0x1D>;
		qcom,mdss-dsi-bl-min-level = <1>;
		qcom,mdss-dsi-bl-max-level = <255>;
		qcom,mdss-dsi-dma-trigger = "trigger_sw";
		qcom,mdss-dsi-mdp-trigger = "none";
		qcom,mdss-dsi-reset-sequence = <1 0>, <0 1>, <1 5>;

		lge,pre-bl-on-delay = <40>;
		lge,mdss-dsi-extra-command-names = "touch-osc-on", "touch-osc-off", "on-command-v09";
		lge,mdss-dsi-extra-command-touch-osc-on = [
			15 01 00 00 01 00 02 BF 20
			15 01 00 00 01 00 02 BF 60
		];
		lge,mdss-dsi-extra-command-touch-osc-off = [
			15 01 00 00 01 00 02 BF 20
			15 01 00 00 01 00 02 BF 00
		];
		lge,mdss-dsi-extra-command-state-touch-osc-on = "dsi_lp_mode";
		lge,mdss-dsi-extra-command-state-touch-osc-off = "dsi_lp_mode";

		lge,blmap-size = <256>;
		lge,blmap = <
			0 45 45 45 45 45 45 45 45 45
			45 47 49 52 54 56 58 60 63 65
			67 69 71 73 76 78 80 82 84 87
			89 91 93 95 98 100 102 104 106 108
			111 113 115 117 119 122 124 126 128 130
			133 135 137 139 141 143 146 148 150 150
			150 150 150 159 167 176 185 193 202 210
			219 228 236 245 254 262 271 280 288 297
			305 314 323 331 340 349 357 366 375 383
			392 400 409 418 426 435 444 452 461 470
			478 487 495 504 513 521 530 530 530 530
			530 530 546 562 578 594 610 625 641 657
			673 689 705 721 737 753 769 785 800 816
			832 848 864 880 896 912 928 944 960 975
			991 1007 1023 1039 1055 1071 1087 1103 1119 1135
			1150 1166 1182 1198 1214 1230 1230 1230 1230 1230
			1230 1230 1255 1280 1305 1330 1356 1381 1406 1431
			1456 1481 1506 1531 1557 1582 1607 1632 1657 1682
			1707 1732 1757 1783 1808 1833 1858 1883 1908 1933
			1958 1983 2009 2034 2059 2084 2109 2134 2159 2184
			2210 2235 2260 2285 2310 2310 2310 2310 2310 2310
			2310 2343 2376 2409 2442 2476 2509 2542 2575 2608
			2641 2674 2707 2740 2774 2807 2840 2873 2906 2939
			2972 3005 3038 3072 3105 3138 3171 3204 3237 3270
			3303 3336 3370 3403 3436 3469 3502 3535 3568 3601
			3634 3668 3701 3734 3767 3800>;

		lge,mdss-dsi-extra-command-on-command-v09 = [
			/* Manufacturer Command Protection */
			15 01 00 00 00 00 02 B0 AC
			/* Display Control 1 */
			39 01 00 00 00 00 05 B1 10 30 16 00
			/* Display Control 2 */
			39 01 00 00 00 00 0D B2 01 00 21 20 58 00 CF 10 1F 1F 34 34
			/* Panel Setting */
			39 01 00 00 00 00 04 B4 00 9F 00
			/* MIPI DSI Configuration */
			39 01 00 00 00 00 06 B5 42 C0 80 10 00
			/* MIPI D-PHY Configuration */
			39 01 00 00 00 00 04 B6 77 34 48
			/* Touch Control */
			39 01 00 00 00 00 0A BD D0 02 F4 01 04 04 12 20 22
			/* LFD Control */
			39 01 00 00 00 00 08 BE E0 E0 C9 C9 C8 F8 00
			/* Power Control 1 */
			39 01 00 00 00 00 07 C1 01 E8 D8 C2 C1 00
			/* Power Control 2 */
			39 01 00 00 00 00 04 C2 3B 13 13
			/* Power Control 3 */
			39 01 00 00 00 00 07 C3 15 2F 2F 00 66 7E
			/* Power Control 4 */
			39 01 00 00 00 00 04 C4 51 00 47
			/* Power Control 5 */
			39 01 00 00 00 00 06 C5 25 20 20 16 16
			/* Temp Control */
			39 01 00 00 00 00 0D C7 10 22 00 28 00 62 62 62 00 B1 01 00
			/* Power Sequence Option Configuration */
			39 01 00 00 00 00 05 C8 01 00 03 8C
			/* Power Control for Touch */
			39 01 00 00 00 00 0F CC 22 2F 11 26 21 24 02 62 62 62 00 B1 01 00
			/* Positive Gamma Curve for Red */
			39 01 00 00 00 00 0D D0 60 47 23 53 23 51 00 00 00 75 56 03
			/* Negative Gamma Curve for Red */
			39 01 00 00 00 00 0D D1 60 47 23 53 23 51 00 00 00 75 56 03
			/* Positive Gamma Curve for Green */
			39 01 00 00 00 00 0D D2 60 47 23 53 23 51 00 00 00 75 56 03
			/* Negative Gamma Curve for Green */
			39 01 00 00 00 00 0D D3 60 47 23 53 23 51 00 00 00 75 56 03
			/* Positive Gamma Curve for Blue */
			39 01 00 00 00 00 0D D4 60 47 23 53 23 71 0F 0F 00 64 56 03
			/* Negative Gamma Curve for Blue */
			39 01 00 00 00 00 0D D5 60 47 23 53 23 71 0F 0F 00 64 56 03
			/* GIP Pad Setting 1 */
			39 01 00 00 00 00 16 E4 2F C3 2F 60 41 C5 C6 CC CC CB 2F CB CA CA C9 C9 C7 C8 2F 41 2F
			/* GIP Pad Setting 2 */
			39 01 00 00 00 00 0D E5 FF FF FF FF FF 13 EF FF FF FF FF 03
			/*MIE*/
			15 01 00 00 00 00 02 55 80
			15 01 00 00 00 00 02 ED 50
			39 01 00 00 00 00 06 F1 00 4A 95 E8 FF
			39 01 00 00 00 00 07 F2 85 00 40 80 C0 FF
			/* Sleep Out */
			05 01 00 00 64 00 01 11
			/* Display On */
			05 01 00 00 00 00 01 29
		];

		lge,mdss-dsi-extra-command-state-on-command-v09 = "dsi_lp_mode";
	};
};
