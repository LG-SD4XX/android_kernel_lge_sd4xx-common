/* Copyright (c) 2012, Code Aurora Forum. All rights reserved.
 *
 * This program is free software; you can redistribute it and/or modify
 * it under the terms of the GNU General Public License version 2 and
 * only version 2 as published by the Free Software Foundation.
 *
 * This program is distributed in the hope that it will be useful,
 * but WITHOUT ANY WARRANTY; without even the implied warranty of
 * MERCHANTABILITY or FITNESS FOR A PARTICULAR PURPOSE.  See the
 * GNU General Public License for more details.
 */


&i2c_8 {
        qcom,disable-dma;
        qcom,clk-freq-out = <400000>;
        cxd224x-i2c@28 {
           compatible = "sony,cxd224x";
           status = "ok";
           reg = <0x28>;
           sony,gpio_sda = <&tlmm 98 0x00>;
           sony,gpio_scl = <&tlmm 99 0x00>;
           sony,gpio_irq = <&tlmm 13 0x00>;
           sony,gpio_hvdd = <&tlmm 94 0x00>;
           sony,gpio_xrst = <&tlmm 95 0x00>;
           sony,gpio_mode = <&tlmm 96 0x00>;
           sony,i2c-pull-up = <1>;
           qcom,clk-src = "BBCLK2";
           interrupt-parent = <&tlmm>;
           interrupts = <13 0>;
           interrupt-names = "nfc_irq";
        };
};
