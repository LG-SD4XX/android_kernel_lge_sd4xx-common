/*
 * Copyright (c) 2016, The Linux Foundation. All rights reserved.
 *
 * This program is free software; you can redistribute it and/or modify
 * it under the terms of the GNU General Public License version 2 and
 * only version 2 as published by the Free Software Foundation.
 *
 * This program is distributed in the hope that it will be useful,
 * but WITHOUT ANY WARRANTY; without even the implied warranty of
 * MERCHANTABILITY or FITNESS FOR A PARTICULAR PURPOSE.  See the
 * GNU General Public License for more details.
 */

&i2c_3 { /* BLSP1 QUP3 */

	status = "okay";
	qcom,clk-freq-out = <400000>;

	sw49107@28 {
		compatible = "lge,sw49107";
		status = "okay";

		reg = <0x28>;
		interrupt-parent = <&tlmm>;
		/* IRQF_ONESHOT			0x00002000 */
		/* IRQF_TRIGGER_FALLING		0x00000002 */
		/* IRQF_NO_SUSPEND		0x00004000 */
		interrupts = <65 0x2002>;
		irqflags = <0x2002>;
		reset-gpio = <&tlmm 64 0x00>;
		irq-gpio = <&tlmm 65 0x2002>;

		pinctrl-names = "touch_pin_active","touch_pin_sleep";	/*Touch GPIO pin name setting*/
		pinctrl-0 = <&ts_int_active &ts_reset_active>;		/*Touch GPIO pin active setting*/
		pinctrl-1 = <&ts_int_suspend &ts_reset_suspend>;	/*Touch GPIO pin suspend setting*/

		/* Caps */
		max_x = <1079>;
		max_y = <2159>;
		max_pressure = <0xff>;
		max_width = <15>;
		max_orientation = <90>;
		max_id = <10>;
		hw_reset_delay = <210>;
		sw_reset_delay = <90>;

		/* Role */
		use_lpwg = <1>;
		use_lpwg_test = <1>;
		hide_coordinate = <0>;

		/* firmware */
		use_fw_upgrade = <1>;
		use_firmware = <0>;
		fw_image = "touch/cv7a/lgsic/L0W62CV7_V1_02.img", "touch/cv7a/lgsic/T0W62CV7_V0_04.img";
		panel_spec = "touch/cv7a/lgsic/cv7a_limit.txt";
		panel_spec_mfts_folder = "touch/cv7a/lgsic/cv7a_limit_mfts.txt";

		/* Performance Test */
		use_perf_test = <1>;
		test_delay = <8>;
		test_pressure = <50>;
		test_width = <100>;
		click_test_x = <135>;
		click_test_y = <526>;
		v_drag_test_x = <108>;
		v_drag_test_start_y = <1388>;
		v_drag_test_end_y = <771>;
		h_drag_test_start_x = <848>;
		h_drag_test_end_x = <231>;
		h_drag_test_y = <1512>;
	};

};
