/* Copyright (c) 2014, Code Aurora Forum. All rights reserved.
 *
 * This program is free software; you can redistribute it and/or modify
 * it under the terms of the GNU General Public License version 2 and
 * only version 2 as published by the Free Software Foundation.
 *
 * This program is distributed in the hope that it will be useful,
 * but WITHOUT ANY WARRANTY; without even the implied warranty of
 * MERCHANTABILITY or FITNESS FOR A PARTICULAR PURPOSE.  See the
 * GNU General Public License for more details.
 */

&mdss_mdp {
	dsi_lgd_incell_sw49106_fhd_incell_vid: qcom,mdss_dsi_lgd_incell_sw49106_fhd_video{
		compatible = "qcom,mdss-dsi-panel";
		status = "ok";
		qcom,cont-splash-enabled;
		qcom,mdss-dsi-panel-name = "LGD INCELL SW49106 FHD video mode dsi panel";
		qcom,mdss-dsi-panel-controller = <&mdss_dsi0>;
		qcom,mdss-dsi-panel-type = "dsi_video_mode";
		qcom,mdss-dsi-panel-destination = "display_1";
		qcom,mdss-dsi-panel-framerate = <60>;
		qcom,mdss-dsi-virtual-channel-id = <0>;
		qcom,mdss-dsi-stream = <0>;
		qcom,mdss-dsi-lp11-init;
		qcom,mdss-dsi-panel-width = <1080>;
		qcom,mdss-dsi-panel-height = <2160>;
		qcom,mdss-dsi-h-front-porch = <8>; // 6
		qcom,mdss-dsi-h-back-porch = <8>; // 8
		qcom,mdss-dsi-h-pulse-width = <4>; // 4
		qcom,mdss-dsi-h-sync-skew = <0>;
		qcom,mdss-dsi-v-front-porch = <172>; // 150
		qcom,mdss-dsi-v-back-porch = <80>; // 92
		qcom,mdss-dsi-v-pulse-width = <1>; // 1
		qcom,mdss-dsi-h-left-border = <0>;
		qcom,mdss-dsi-h-right-border = <0>;
		qcom,mdss-dsi-v-top-border = <0>;
		qcom,mdss-dsi-v-bottom-border = <0>;

		qcom,mdss-pan-physical-width-dimension = <62>;
		qcom,mdss-pan-physical-height-dimension = <124>;

		qcom,mdss-dsi-bpp = <24>;
		qcom,mdss-dsi-color-order = "rgb_swap_rgb";
		qcom,mdss-dsi-underflow-color = <0xFF>;
		qcom,mdss-dsi-border-color = <0xFF>;

		qcom,mdss-dsi-pan-enable-dynamic-fps;
		qcom,mdss-dsi-pan-fps-update = "dfps_immediate_porch_mode_vfp";
		qcom,mdss-dsi-min-refresh-rate = <54>;

		/* NOTE : if changed, take a look at "lpwg-on" cmds also */
		qcom,mdss-dsi-on-command = [
			05 01 00 00 00 00 01 //te_on
			35

			15 01 00 00 00 00 02 // flip
			36 00

			15 01 00 00 00 00 02 // blu_ctrl1
			51 FF

			15 01 00 00 00 00 02 // blu_ctrl2
			53 2C

			15 01 00 00 00 00 02 // IE Enable
			55 81

			15 01 00 00 00 00 02 // CABC min set
			5E 00

			39 01 00 00 00 00 02 // manufacturer_protection
			B0 AC

			39 01 00 00 00 00 06 // DSI Error Report Mask
			B1 46 00 80 14
			85

			39 01 00 00 00 00 08 // disp_ctrl1
			B3 05 08 14 00
			1C 00 02

			39 01 00 00 00 00 10 // disp_ctrl2
			B4 83 08 00 04
			04 04 04 00 00
			00 00 00 00 00
			00

			39 01 00 00 00 00 13 // disp_ctrl3
			B5 03 1E 0B 02
			29 00 00 00 00
			04 00 24 00 10
			10 10 10 00

			39 01 00 00 00 00 0A // disp_ctrl4
			B6 00 72 39 13
			08 67 00 60 46

			39 01 00 00 00 00 05 // panel_setting
			B7 00 50 37 04

			39 01 00 00 00 00 0C // touch_timing_ctrl
			B8 70 38 14 ED
			08 04 00 01 CC
			C8 8C

			39 01 00 00 00 00 06 // int_osc_setting
			C0 8A 8F 18 C1
			12

			39 01 00 00 00 00 07 // pwr_ctrl1
			C1 01 00 30 C2
			C7 0F

			39 01 00 00 00 00 03 // pwr_ctrl2
			C2 2A 00

			39 01 00 00 00 00 07 // pwr_ctrl3
			C3 05 0E 0E 50
			88 09

			39 01 00 00 00 00 04 // pwr_ctrl4
			C4 A2 F3 F2

			39 01 00 00 00 00 05 // pwr_ctrl5
			C5 C2 2A 49 07

			39 01 00 00 00 00 03 // vcom_setting
			C6 15 01

			39 01 00 00 00 00 07 // pwr_seq_in_sleep_mode
			CA 00 00 03 84
			55 F5

			39 01 00 00 00 00 03 // abrupt power off ctrl
			CB 3F A0

			39 01 00 00 00 00 09 // lfd_setting
			CC F0 03 10 55
			11 FC 34 34

			39 01 00 00 00 00 07 // tail tft setting
			CD 11 50 50 90
			00 F3

			39 01 00 00 00 00 07 // touch_pwr_ctrl
			CE A0 28 28 34
			00 AB

			39 01 00 00 00 00 10 // pos_gamma_for_red
			D0 0D 16 20 2C
			33 41 4B 58 47
			3C 2C 1C 09 00
			82

			39 01 00 00 00 00 10 // neg_gamma_for_red
			D1 0D 16 20 2C
			33 41 4B 58 47
			3C 2C 1C 09 00
			82

			39 01 00 00 00 00 10 // pos_gamma_for_green
			D2 0D 16 20 2D
			35 42 4C 58 47
			3C 2C 1C 09 00
			82

			39 01 00 00 00 00 10 // neg_gamma_for_green
			D3 0D 16 20 2D
			35 42 4C 58 47
			3C 2C 1C 09 00
			82

			39 01 00 00 00 00 10 // pos_gamma_for_blue
			D4 0D 16 20 2B
			32 42 4C 59 46
			3C 2D 1D 08 00
			82

			39 01 00 00 00 00 10 // neg_gamma_for_blue
			D5 0D 16 20 2B
			32 42 4C 59 46
			3C 2D 1D 08 00
			82

			39 01 00 00 00 00 0D // left_side_gip_setting
			E5 24 23 11 10
			00 0A 08 06 04
			11 0E 23

			39 01 00 00 00 00 0D // right_side_gip_setting
			E6 24 23 11 10
			01 0B 09 07 05
			11 0E 23

			39 01 00 00 00 00 07 // left_side_mux_setting
			E7 15 16 17 18
			19 1A

			39 01 00 00 00 00 07 // right_side_mux_setting
			E8 1B 1C 1D 1E
			1F 20

			39 01 00 00 00 00 05 // abnormal_pwr_off
			ED 00 01 53 0C

			39 01 00 00 00 00 03 // SAT, SH Enable
			F0 82 00

			39 01 00 00 00 00 05 // Sharpness
			F2 01 00 17 00

			39 01 00 00 00 00 07 // All Color Saturation
			F3 00 60 A0 D9
			00 01

			39 01 00 00 00 00 11 // CABC GMR
			F4 40 40 40 40
			40 40 40 40 00
			00 00 00 00 00
			00 00

			39 01 00 00 00 00 11 // CABC GMG
			F5 40 40 40	40
			40 40 40 40	00
			00 00 00 00 00
			00 00

			39 01 00 00 00 00 11 // CABC GMB
			F6 30 30 30 30
			30 30 30 30 00
			00 00 00 00 00
			00 00

			39 01 00 00 00 00 1A // CABC SRESI
			F7 70 00 2A 55
			78 98 B6 D0 E7
			00 3A 65 88 A7
			C1 DA E8 00 44
			6C 93 B1 C8 DF
			EF

			39 01 00 00 00 00 18 // CABC ctrl1
			F9 20 40 60 80
			A0 C0 E0 20 20
			20 14 0C 05 05
			00 B4 C0 CD DA
			E8 F0 F7 FF

			39 01 00 00 00 00 0F // CABC ctrl2
			FA FF 12 22 22
			10 00 70 82 02
			60 08 70 42 1C
		];

		lge,mdss-dsi-extra-command-names = "sleep-in", "sleep-out", "lpwg-on", "cabc-enable", "cabc-disable", "dic-read";

		lge,mdss-dsi-extra-command-sleep-in = [
			05 01 00 00 32 00 01 /* Display off */
			28

			05 01 00 00 64 00 01 /* Sleep in */
			10
		];
		lge,mdss-dsi-extra-command-state-sleep-in = "dsi_hs_mode";

		lge,mdss-dsi-extra-command-sleep-out = [
			05 01 00 00 64 00 01 /* Sleep out */
			11

			05 01 00 00 05 00 01 /* Display On */
			29
		];
		lge,mdss-dsi-extra-command-state-sleep-out = "dsi_lp_mode";

		lge,mdss-dsi-extra-command-lpwg-on = [
			39 01 00 00 00 00 02 // manufacturer_protection
			B0 AC

			39 01 00 00 00 00 07 // pwr_ctrl1
			C1 01 00 30 C2
			C7 0F

			39 01 00 00 00 00 07 // pwr_ctrl3
			C3 05 0E 0E 50
			88 09

			39 01 00 00 00 00 03 // vcom_setting
			C6 15 01

			39 01 00 00 00 00 09 // lfd_setting
			CC F0 03 10 55
			11 FC 34 34

			39 01 00 00 00 00 07 // touch_pwr_ctrl
			CE A0 28 28 34
			00 AB

			39 01 00 00 00 00 0D // left_side_gip_setting
			E5 24 23 11 10
			00 0A 08 06 04
			11 0E 23

			39 01 00 00 00 00 0D // right_side_gip_setting
			E6 24 23 11 10
			01 0B 09 07 05
			11 0E 23

			39 01 00 00 32 00 05 // abnormal_pwr_off
			ED 00 01 53 0C
		];
		lge,mdss-dsi-extra-command-state-lpwg-on = "dsi_lp_mode";

		lge,mdss-dsi-extra-command-cabc-enable = [
			15 01 00 00 00 00 02 // IE Enable
			55 81

			39 01 00 00 00 00 0F
			FA FF 12 22 22
			10 00 70 82 02
			60 08 70 42 1C
		];
		lge,mdss-dsi-extra-command-state-cabc-enable = "dsi_hs_mode";

		lge,mdss-dsi-extra-command-cabc-disable = [
			15 01 00 00 00 00 02 // IE Enable
			55 80

			39 01 00 00 00 00 0F
			FA FF 12 22 22
			10 00 70 80 02
			60 08 70 42 1C
		];
		lge,mdss-dsi-extra-command-state-cabc-disable = "dsi_hs_mode";

		lge,mdss-dsi-extra-command-dic-read = [
			06 01 00 00 05 00 02 // display block power state
			0A 00

			06 01 00 00 05 00 08 // disp_ctrl1
			B3 05 08 14 00
			1C 00 02
			06 01 00 00 05 00 10 // disp_ctrl2
			B4 83 08 00 04
			04 04 04 00 00
			00 00 00 00 00
			00
			06 01 00 00 05 00 13 // disp_ctrl3
			B5 03 1E 0B 02
			29 00 00 00 00
			04 00 24 00 10
			10 10 10 00
			06 01 00 00 05 00 0A // disp_ctrl4
			B6 00 72 39 13
			08 67 00 60 46

			06 01 00 00 05 00 0C // touch_timing_ctrl
			B8 70 38 14 ED
			08 04 00 01 0A
			A0 00
		];
		lge,mdss-dsi-extra-command-state-dic-read = "dsi_hs_mode";

		qcom,mdss-dsi-on-command-state = "dsi_lp_mode";
		qcom,mdss-dsi-off-command-state = "dsi_hs_mode";
		qcom,mdss-dsi-reader-mode-command-state = "dsi_hs_mode";
		qcom,mdss-dsi-h-sync-pulse = <1>;
		qcom,mdss-dsi-traffic-mode = "non_burst_sync_pulse";
		qcom,mdss-dsi-lane-map = "lane_map_0123";
		qcom,mdss-dsi-dma-trigger = "trigger_sw";
		qcom,mdss-dsi-mdp-trigger = "none";
		qcom,mdss-dsi-bllp-eof-power-mode;
		qcom,mdss-dsi-bllp-power-mode;
		qcom,suspend-ulps-enabled;
		//qcom,mdss-dsi-force-clock-lane-hs;
		qcom,mdss-dsi-lane-0-state;
		qcom,mdss-dsi-lane-1-state;
		qcom,mdss-dsi-lane-2-state;
		qcom,mdss-dsi-lane-3-state;
		qcom,mdss-dsi-tx-eot-append;

		qcom,mdss-dsi-panel-timings-phy-v2 = [
			24 20 08 0A 05 03 04 a0
			24 20 08 0A 05 03 04 a0
			24 20 08 0A 05 03 04 a0
			24 20 08 0A 05 03 04 a0
			24 1D 08 0A 05 03 04 a0
		];

		qcom,mdss-dsi-t-clk-post = <0x0E>;
		qcom,mdss-dsi-t-clk-pre = <0x32>;

		qcom,mdss-dsi-bl-min-level = <1>;
		qcom,mdss-dsi-bl-max-level = <255>;
		qcom,mdss-dsi-bl-pmic-control-type = "bl_ctrl_wled";
		qcom,mdss-dsi-reset-sequence = <0 1>, <1 1>;

		lge,mdss-dsi-lp11-off;

		lge,blmap-size = <256>;
		lge,blmap = <
			0	23	23	23	23	23	23	23	23	23		/* 0 ~ 9 */
			23	23	23	23	24	24	24	25	25	25		/* 10 ~ 19 */
			26	26	26	27	28	30	31	33	34	36		/* 20 ~ 29 */
			37	39	40	42	43	45	47	49	51	53		/* 30 ~ 39 */
			55	57	60	62	64	66	68	70	72	75		/* 40 ~ 49 */
			80	85	90	95	100	105	110	115	120	125		/* 50 ~ 59 */
			129	134	138	143	148	152	157	162	166	171		/* 60 ~ 69 */
			176	180	185	190	196	202	208	215	221	227		/* 70 ~ 79 */
			233	240	246	252	258	265	273	281	289	297		/* 80 ~ 89 */
			305	313	321	329	337	345	353	361	370	381		/* 90 ~ 99 */
			393	405	417	429	440	452	464	476	488	500		/* 100 ~ 109 */
			510	521	532	543	553	564	575	586	596	607		/* 110 ~ 119 */
			618	629	640	653	667	681	695	708	722	736		/* 120 ~ 129 */
			750	763	777	791	805	822	840	858	875	893		/* 130 ~ 139 */
			911	929	946	964	982	1000	1017	1034	1051	1069		/* 140 ~ 149 */
			1086	1103	1121	1138	1155	1173	1200	1207	1225	1245		/* 150 ~ 159 */
			1265	1286	1306	1327	1347	1367	1388	1408	1429	1449		/* 160 ~ 169 */
			1470	1491	1513	1534	1556	1577	1599	1620	1642	1663		/* 170 ~ 179 */
			1685	1706	1728	1750	1776	1802	1828	1855	1881	1907		/* 180 ~ 189 */
			1933	1960	1986	2012	2038	2065	2090	2116	2142	2168		/* 190 ~ 199 */
			2193	2219	2245	2271	2296	2322	2348	2374	2400	2434		/* 200 ~ 209 */
			2469	2503	2538	2572	2607	2641	2676	2710	2745	2780		/* 210 ~ 219 */
			2811	2843	2874	2906	2937	2969	3000	3032	3063	3095		/* 220 ~ 229 */
			3126	3158	3190	3227	3265	3303	3341	3379	3417	3455		/* 230 ~ 239 */
			3493	3531	3569	3607	3645	3685	3726	3767	3808	3849		/* 240 ~ 249 */
			3890	3931	3972	4013	4054	4095						/* 250 ~ 255 */
		>;

	};
};
