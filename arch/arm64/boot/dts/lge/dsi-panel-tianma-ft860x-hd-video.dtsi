/* Copyright (c) 2013, The Linux Foundation. All rights reserved.
 *
 * This program is free software; you can redistribute it and/or modify
 * it under the terms of the GNU General Public License version 2 and
 * only version 2 as published by the Free Software Foundation.
 *
 * This program is distributed in the hope that it will be useful,
 * but WITHOUT ANY WARRANTY; without even the implied warranty of
 * MERCHANTABILITY or FITNESS FOR A PARTICULAR PURPOSE.  See the
 * GNU General Public License for more details.
 */

/*---------------------------------------------------------------------------
 * This file is autogenerated file using gcdb parser. Please do not edit it.
 * Update input XML file to add a new entry or update variable in this file
 * VERSION = "1.0"
 *---------------------------------------------------------------------------*/
&mdss_mdp {
	dsi_tianma_ft860x_hd_video: qcom,mdss_dsi_tianma_ft860x_hd_video {
		compatible = "qcom,mdss-dsi-panel";
		status = "ok";
		qcom,cont-splash-enabled;
		qcom,mdss-dsi-panel-name = "tianma ft860x 720p video mode dsi panel";
		qcom,mdss-dsi-panel-controller = <&mdss_dsi0>;
		qcom,mdss-dsi-panel-type = "dsi_video_mode";
		qcom,mdss-dsi-panel-destination = "display_1";
		qcom,mdss-dsi-panel-framerate = <60>;
		qcom,mdss-pan-physical-width-dimension = < 62 >;
		qcom,mdss-pan-physical-height-dimension = < 110 >;
		qcom,mdss-dsi-virtual-channel-id = <0>;
		qcom,mdss-dsi-stream = <0>;
		qcom,mdss-dsi-panel-width = <720>;
		qcom,mdss-dsi-panel-height = <1280>;
		qcom,mdss-dsi-h-front-porch = <96>;
		qcom,mdss-dsi-h-back-porch = <51>;
		qcom,mdss-dsi-h-pulse-width = <4>;
		qcom,mdss-dsi-h-sync-skew = <0>;
		qcom,mdss-dsi-v-back-porch = <25>;
		qcom,mdss-dsi-v-front-porch = <30>;
		qcom,mdss-dsi-v-pulse-width = <4>;
		qcom,mdss-dsi-h-left-border = <0>;
		qcom,mdss-dsi-h-right-border = <0>;
		qcom,mdss-dsi-v-top-border = <0>;
		qcom,mdss-dsi-v-bottom-border = <0>;
		qcom,mdss-dsi-bpp = <24>;
		qcom,mdss-dsi-color-order = "rgb_swap_rgb";
		qcom,mdss-dsi-underflow-color = <0xff>;
		qcom,mdss-dsi-border-color = <0>;
		qcom,mdss-dsi-on-command = [
			05 01 00 00 78 00 01 11
			05 01 00 00 00 00 01 29
		];
		qcom,mdss-dsi-off-command = [05 01 00 00 00 00 01 28
					05 01 00 00 78 00 01 10];

		lge,comfort-view-cmds-off = [		// NORMAL
			39 01 00 00 00 00 06 F0 46 23 11 01 01
			39 01 00 00 00 00 3D D2 00 00 00 20 00 4C 00 74 00 7E 00 8A 00 9A 00 A6 00 B2 00 E1 01 02 01 35 01 5C 01 98 01 CC 01 CE 02 0B 02 5D 02 8E 02 CB 02 F1 03 26 03 35 03 45 03 57 03 6B 03 82 03 9E 03 C3 03 DF
			39 01 00 00 00 00 3D D3 00 00 00 26 00 50 00 79 00 81 00 90 00 A1 00 A9 00 B8 00 E8 01 06 01 3E 01 65 01 A3 01 DA 01 DC 02 27 02 7A 02 B0 02 F4 03 18 03 57 03 5D 03 66 03 77 03 8E 03 A5 03 C1 03 E6 03 FF
			39 01 00 00 00 00 3D D1 00 00 00 22 00 39 00 63 00 6C 00 7A 00 86 00 94 00 A0 00 D0 00 F0 01 27 01 4D 01 88 01 BE 01 C0 01 FA 02 3C 02 64 02 94 02 B1 02 D4 02 DD 02 E8 02 F3 02 FE 03 0A 03 16 03 25 03 2F
			39 01 00 00 00 00 3D D5 00 00 00 20 00 4C 00 74 00 7E 00 8A 00 9A 00 A6 00 B2 00 E1 01 02 01 35 01 5C 01 98 01 CC 01 CE 02 0B 02 5D 02 8E 02 CB 02 F1 03 26 03 35 03 45 03 57 03 6B 03 82 03 9E 03 C3 03 DF
			39 01 00 00 00 00 3D D6 00 00 00 26 00 50 00 79 00 81 00 90 00 A1 00 A9 00 B8 00 E8 01 06 01 3E 01 65 01 A3 01 DA 01 DC 02 27 02 7A 02 B0 02 F4 03 18 03 57 03 5D 03 66 03 77 03 8E 03 A5 03 C1 03 E6 03 FF
			39 01 00 00 00 00 3D D4 00 00 00 22 00 39 00 63 00 6C 00 7A 00 86 00 94 00 A0 00 D0 00 F0 01 27 01 4D 01 88 01 BE 01 C0 01 FA 02 3C 02 64 02 94 02 B1 02 D4 02 DD 02 E8 02 F3 02 FE 03 0A 03 16 03 25 03 2F
			39 01 00 00 00 00 05 D0 0F 0F 0F 0F
			39 01 00 00 00 00 06 F0 46 23 11 00 01
		];

		lge,comfort-view-cmds-step1 = [ /* 7000K */
			39 01 00 00 00 00 06 F0 46 23 11 01 01
			39 01 00 00 00 00 05 D0 0F 0F 0F 0F
			39 01 00 00 00 00 3D D3 00 00 00 05 00 20 00 42 00 5A 00 71 00 85 00 95 00 A4 00 D3 00 F6 01 2C 01 52 01 91 01 CA 01 CC 02 0A 02 57 02 87 02 C2 02 E5 03 0F 03 1B 03 27 03 34 03 41 03 50 03 60 03 71 03 7A
			39 01 00 00 00 00 3D D2 00 00 00 05 00 21 00 44 00 5D 00 74 00 87 00 98 00 A7 00 D5 00 F9 01 2C 01 53 01 92 01 CC 01 CE 02 0F 02 5F 02 93 02 D5 02 FF 03 33 03 43 03 54 03 68 03 7E 03 98 03 B8 03 E2 03 FF
			39 01 00 00 00 00 3D D1 00 00 00 05 00 1F 00 41 00 59 00 71 00 84 00 94 00 A3 00 D2 00 F5 01 27 01 4D 01 8A 01 C1 01 C3 02 00 02 4A 02 77 02 AF 02 CF 02 F6 03 00 03 0D 03 1A 03 27 03 34 03 43 03 55 03 5E
			39 01 00 00 00 00 3D D6 00 00 00 05 00 20 00 42 00 5A 00 71 00 85 00 95 00 A4 00 D3 00 F6 01 2C 01 52 01 91 01 CA 01 CC 02 0A 02 57 02 87 02 C2 02 E5 03 0F 03 1B 03 27 03 34 03 41 03 50 03 60 03 71 03 7A
			39 01 00 00 00 00 3D D5 00 00 00 05 00 21 00 44 00 5D 00 74 00 87 00 98 00 A7 00 D5 00 F9 01 2C 01 53 01 92 01 CC 01 CE 02 0F 02 5F 02 93 02 D5 02 FF 03 33 03 43 03 54 03 68 03 7E 03 98 03 B8 03 E2 03 FF
			39 01 00 00 00 00 3D D4 00 00 00 05 00 1F 00 41 00 59 00 71 00 84 00 94 00 A3 00 D2 00 F5 01 27 01 4D 01 8A 01 C1 01 C3 02 00 02 4A 02 77 02 AF 02 CF 02 F6 03 00 03 0D 03 1A 03 27 03 34 03 43 03 55 03 5E
			39 01 00 00 00 00 06 F0 46 23 11 00 01
		];
		lge,comfort-view-cmds-step2 = [ /* 6500K */
			39 01 00 00 00 00 06 F0 46 23 11 01 01
			39 01 00 00 00 00 05 D0 0F 0F 0F 0F
			39 01 00 00 00 00 3D D3 00 00 00 09 00 36 00 50 00 69 00 7B 00 8C 00 9B 00 A9 00 D4 00 F7 01 2D 01 53 01 90 01 C8 01 CA 02 07 02 51 02 7F 02 B7 02 D7 02 FD 03 08 03 14 03 1F 03 2B 03 37 03 45 03 54 03 5C
			39 01 00 00 00 00 3D D2 00 00 00 0A 00 37 00 54 00 6D 00 7F 00 90 00 A0 00 AD 00 DB 00 FD 01 31 01 57 01 95 01 CF 01 D1 02 12 02 64 02 98 02 DA 03 05 03 39 03 49 03 5A 03 6E 03 84 03 9E 03 BD 03 E5 03 FF
			39 01 00 00 00 00 3D D1 00 00 00 09 00 37 00 53 00 6D 00 7F 00 90 00 A0 00 AD 00 DB 00 FD 01 31 01 56 01 95 01 CE 01 D0 02 11 02 63 02 97 02 D9 03 02 03 37 03 46 03 57 03 6B 03 81 03 9A 03 B8 03 DF 03 F8
			39 01 00 00 00 00 3D D6 00 00 00 09 00 36 00 50 00 69 00 7B 00 8C 00 9B 00 A9 00 D4 00 F7 01 2D 01 53 01 90 01 C8 01 CA 02 07 02 51 02 7F 02 B7 02 D7 02 FD 03 08 03 14 03 1F 03 2B 03 37 03 45 03 54 03 5C
			39 01 00 00 00 00 3D D5 00 00 00 0A 00 37 00 54 00 6D 00 7F 00 90 00 A0 00 AD 00 DB 00 FD 01 31 01 57 01 95 01 CF 01 D1 02 12 02 64 02 98 02 DA 03 05 03 39 03 49 03 5A 03 6E 03 84 03 9E 03 BD 03 E5 03 FF
			39 01 00 00 00 00 3D D4 00 00 00 09 00 37 00 53 00 6D 00 7F 00 90 00 A0 00 AD 00 DB 00 FD 01 31 01 56 01 95 01 CE 01 D0 02 11 02 63 02 97 02 D9 03 02 03 37 03 46 03 57 03 6B 03 81 03 9A 03 B8 03 DF 03 F8
			39 01 00 00 00 00 06 F0 46 23 11 00 01
		];
		lge,comfort-view-cmds-step3 = [ /* 6000K */
			39 01 00 00 00 00 06 F0 46 23 11 01 01
			39 01 00 00 00 00 05 D0 0F 0F 0F 0F
			39 01 00 00 00 00 3D D3 00 00 00 04 00 18 00 39 00 50 00 67 00 79 00 8A 00 99 00 C4 00 E7 01 1C 01 42 01 7C 01 B1 01 B3 01 EA 02 27 02 4B 02 73 02 89 02 A3 02 A9 02 B0 02 B7 02 BE 02 C5 02 CC 02 D2 02 D6
			39 01 00 00 00 00 3D D2 00 00 00 05 00 1C 00 3E 00 56 00 6F 00 83 00 94 00 A3 00 D1 00 F4 01 27 01 4D 01 8A 01 C2 01 C4 02 00 02 4A 02 77 02 AE 02 CE 02 F5 02 FF 03 0B 03 17 03 24 03 30 03 3F 03 4F 03 58
			39 01 00 00 00 00 3D D1 00 00 00 05 00 1E 00 41 00 5A 00 73 00 87 00 98 00 A8 00 D5 00 F9 01 2B 01 52 01 92 01 CD 01 CF 02 0F 02 60 02 94 02 D6 03 01 03 35 03 45 03 57 03 6B 03 82 03 9C 03 BB 03 E4 03 FF
			39 01 00 00 00 00 3D D6 00 00 00 04 00 18 00 39 00 50 00 67 00 79 00 8A 00 99 00 C4 00 E7 01 1C 01 42 01 7C 01 B1 01 B3 01 EA 02 27 02 4B 02 73 02 89 02 A3 02 A9 02 B0 02 B7 02 BE 02 C5 02 CC 02 D2 02 D6
			39 01 00 00 00 00 3D D5 00 00 00 05 00 1C 00 3E 00 56 00 6F 00 83 00 94 00 A3 00 D1 00 F4 01 27 01 4D 01 8A 01 C2 01 C4 02 00 02 4A 02 77 02 AE 02 CE 02 F5 02 FF 03 0B 03 17 03 24 03 30 03 3F 03 4F 03 58
			39 01 00 00 00 00 3D D4 00 00 00 05 00 1E 00 41 00 5A 00 73 00 87 00 98 00 A8 00 D5 00 F9 01 2B 01 52 01 92 01 CD 01 CF 02 0F 02 60 02 94 02 D6 03 01 03 35 03 45 03 57 03 6B 03 82 03 9C 03 BB 03 E4 03 FF
			39 01 00 00 00 00 06 F0 46 23 11 00 01
		];
		lge,comfort-view-cmds-step4 = [ /* 5500K */
			39 01 00 00 00 00 06 F0 46 23 11 01 01
			39 01 00 00 00 00 05 D0 0F 0F 0F 0F
			39 01 00 00 00 00 3D D3 00 00 00 02 00 12 00 30 00 47 00 5C 00 72 00 83 00 91 00 BB 00 DE 01 13 01 3A 01 71 01 A4 01 A6 01 D8 02 0E 02 2C 02 4D 02 5F 02 72 02 77 02 7C 02 81 02 86 02 8B 02 90 02 95 02 98
			39 01 00 00 00 00 3D D2 00 00 00 02 00 17 00 3A 00 52 00 6C 00 7F 00 90 00 A0 00 CC 00 F0 01 22 01 49 01 85 01 BD 01 BE 01 F9 02 3F 02 69 02 9C 02 BA 02 DB 02 E6 02 F0 02 FA 03 05 03 11 03 1D 03 29 03 2F
			39 01 00 00 00 00 3D D1 00 00 00 02 00 1A 00 3E 00 57 00 71 00 86 00 97 00 A7 00 D4 00 F8 01 2A 01 52 01 91 01 CC 01 CE 02 0F 02 5E 02 92 02 D4 03 00 03 33 03 44 03 56 03 6A 03 80 03 9B 03 BB 03 E4 03 FF
			39 01 00 00 00 00 3D D6 00 00 00 02 00 12 00 30 00 47 00 5C 00 72 00 83 00 91 00 BB 00 DE 01 13 01 3A 01 71 01 A4 01 A6 01 D8 02 0E 02 2C 02 4D 02 5F 02 72 02 77 02 7C 02 81 02 86 02 8B 02 90 02 95 02 98
			39 01 00 00 00 00 3D D5 00 00 00 02 00 17 00 3A 00 52 00 6C 00 7F 00 90 00 A0 00 CC 00 F0 01 22 01 49 01 85 01 BD 01 BE 01 F9 02 3F 02 69 02 9C 02 BA 02 DB 02 E6 02 F0 02 FA 03 05 03 11 03 1D 03 29 03 2F
			39 01 00 00 00 00 3D D4 00 00 00 02 00 1A 00 3E 00 57 00 71 00 86 00 97 00 A7 00 D4 00 F8 01 2A 01 52 01 91 01 CC 01 CE 02 0F 02 5E 02 92 02 D4 03 00 03 33 03 44 03 56 03 6A 03 80 03 9B 03 BB 03 E4 03 FF
			39 01 00 00 00 00 06 F0 46 23 11 00 01
		];
		lge,comfort-view-cmds-step5 = [ /* 5000K */
			39 01 00 00 00 00 06 F0 46 23 11 01 01
			39 01 00 00 00 00 05 D0 0F 0F 0F 0F
			39 01 00 00 00 00 3D D3 00 00 00 03 00 11 00 29 00 41 00 54 00 68 00 78 00 88 00 B1 00 D5 01 08 01 2E 01 63 01 94 01 95 01 BF 01 ED 02 05 02 1F 02 2C 02 3A 02 3E 02 41 02 45 02 48 02 4B 02 4F 02 52 02 53
			39 01 00 00 00 00 3D D2 00 00 00 03 00 18 00 39 00 50 00 68 00 7B 00 8D 00 9C 00 C7 00 EB 01 1C 01 42 01 7D 01 B3 01 B4 01 EC 02 2B 02 50 02 7B 02 93 02 B0 02 B7 02 BF 02 C6 02 CE 02 D5 02 DF 02 E8 02 ED
			39 01 00 00 00 00 3D D1 00 00 00 04 00 1C 00 3F 00 59 00 73 00 87 00 99 00 A8 00 D6 00 F9 01 2C 01 52 01 92 01 CE 01 CF 02 10 02 60 02 94 02 D7 03 02 03 36 03 46 03 58 03 6C 03 82 03 9C 03 BB 03 E5 03 FF
			39 01 00 00 00 00 3D D6 00 00 00 03 00 11 00 29 00 41 00 54 00 68 00 78 00 88 00 B1 00 D5 01 08 01 2E 01 63 01 94 01 95 01 BF 01 ED 02 05 02 1F 02 2C 02 3A 02 3E 02 41 02 45 02 48 02 4B 02 4F 02 52 02 53
			39 01 00 00 00 00 3D D5 00 00 00 03 00 18 00 39 00 50 00 68 00 7B 00 8D 00 9C 00 C7 00 EB 01 1C 01 42 01 7D 01 B3 01 B4 01 EC 02 2B 02 50 02 7B 02 93 02 B0 02 B7 02 BF 02 C6 02 CE 02 D5 02 DF 02 E8 02 ED
			39 01 00 00 00 00 3D D4 00 00 00 04 00 1C 00 3F 00 59 00 73 00 87 00 99 00 A8 00 D6 00 F9 01 2C 01 52 01 92 01 CE 01 CF 02 10 02 60 02 94 02 D7 03 02 03 36 03 46 03 58 03 6C 03 82 03 9C 03 BB 03 E5 03 FF
			39 01 00 00 00 00 06 F0 46 23 11 00 01
		];
		lge,comfort-view-cmds-step6 = [ /* 4500K */
			39 01 00 00 00 00 06 F0 46 23 11 01 01
			39 01 00 00 00 00 05 D0 0F 0F 0F 0F
			39 01 00 00 00 00 3D D3 00 00 00 01 00 0C 00 20 00 3A 00 4E 00 5F 00 6F 00 7B 00 A8 00 C5 01 00 01 21 01 58 01 7F 01 81 01 A8 01 D0 01 E2 01 F6 02 01 02 0B 02 0D 02 10 02 12 02 15 02 17 02 19 02 1B 02 1C
			39 01 00 00 00 00 3D D2 00 00 00 02 00 14 00 36 00 50 00 65 00 77 00 88 00 97 00 C2 00 E7 01 16 01 3E 01 74 01 A9 01 AA 01 DE 02 17 02 38 02 5C 02 70 02 86 02 8C 02 92 02 98 02 9F 02 A6 02 AC 02 B3 02 B7
			39 01 00 00 00 00 3D D1 00 00 00 04 00 1C 00 41 00 5E 00 75 00 88 00 9A 00 A9 00 D9 00 FC 01 30 01 55 01 95 01 CF 01 D1 02 12 02 64 02 99 02 DD 03 09 03 3E 03 4E 03 60 03 74 03 8A 03 A4 03 C2 03 E8 03 FF
			39 01 00 00 00 00 3D D6 00 00 00 01 00 0C 00 20 00 3A 00 4E 00 5F 00 6F 00 7B 00 A8 00 C5 01 00 01 21 01 58 01 7F 01 81 01 A8 01 D0 01 E2 01 F6 02 01 02 0B 02 0D 02 10 02 12 02 15 02 17 02 19 02 1B 02 1C
			39 01 00 00 00 00 3D D5 00 00 00 02 00 14 00 36 00 50 00 65 00 77 00 88 00 97 00 C2 00 E7 01 16 01 3E 01 74 01 A9 01 AA 01 DE 02 17 02 38 02 5C 02 70 02 86 02 8C 02 92 02 98 02 9F 02 A6 02 AC 02 B3 02 B7
			39 01 00 00 00 00 3D D4 00 00 00 04 00 1C 00 41 00 5E 00 75 00 88 00 9A 00 A9 00 D9 00 FC 01 30 01 55 01 95 01 CF 01 D1 02 12 02 64 02 99 02 DD 03 09 03 3E 03 4E 03 60 03 74 03 8A 03 A4 03 C2 03 E8 03 FF
			39 01 00 00 00 00 06 F0 46 23 11 00 01
		];
		lge,comfort-view-cmds-step7 = [ /* 4000K */
			39 01 00 00 00 00 06 F0 46 23 11 01 01
			39 01 00 00 00 00 05 D0 0F 0F 0F 0F
			39 01 00 00 00 00 3D D3 00 00 00 03 00 0D 00 24 00 3C 00 4E 00 5E 00 6D 00 78 00 A2 00 BE 00 FA 01 1B 01 51 01 77 01 78 01 9E 01 C1 01 D3 01 E3 01 EC 01 F5 01 F7 01 F9 01 FB 01 FD 01 FE 02 00 02 02 02 02
			39 01 00 00 00 00 3D D2 00 00 00 04 00 1A 00 3C 00 57 00 6A 00 7B 00 8B 00 9A 00 C3 00 E7 01 17 01 3E 01 75 01 AA 01 AB 01 DE 02 17 02 37 02 5B 02 6F 02 85 02 8A 02 90 02 96 02 9C 02 A3 02 AA 02 B1 02 B4
			39 01 00 00 00 00 3D D1 00 00 00 06 00 24 00 48 00 63 00 79 00 8C 00 9D 00 AB 00 DB 00 FE 01 32 01 57 01 96 01 D0 01 D2 02 14 02 66 02 9C 02 E0 03 0B 03 40 03 51 03 63 03 77 03 8C 03 A6 03 C4 03 E8 03 FF
			39 01 00 00 00 00 3D D6 00 00 00 03 00 0D 00 24 00 3C 00 4E 00 5E 00 6D 00 78 00 A2 00 BE 00 FA 01 1B 01 51 01 77 01 78 01 9E 01 C1 01 D3 01 E3 01 EC 01 F5 01 F7 01 F9 01 FB 01 FD 01 FE 02 00 02 02 02 02
			39 01 00 00 00 00 3D D5 00 00 00 04 00 1A 00 3C 00 57 00 6A 00 7B 00 8B 00 9A 00 C3 00 E7 01 17 01 3E 01 75 01 AA 01 AB 01 DE 02 17 02 37 02 5B 02 6F 02 85 02 8A 02 90 02 96 02 9C 02 A3 02 AA 02 B1 02 B4
			39 01 00 00 00 00 3D D4 00 00 00 06 00 24 00 48 00 63 00 79 00 8C 00 9D 00 AB 00 DB 00 FE 01 32 01 57 01 96 01 D0 01 D2 02 14 02 66 02 9C 02 E0 03 0B 03 40 03 51 03 63 03 77 03 8C 03 A6 03 C4 03 E8 03 FF
			39 01 00 00 00 00 06 F0 46 23 11 00 01
		];
		lge,comfort-view-cmds-step8 = [ /* 3500K */
			39 01 00 00 00 00 06 F0 46 23 11 01 01
			39 01 00 00 00 00 05 D0 0F 0F 0F 0F
			39 01 00 00 00 00 3D D3 00 00 00 01 00 06 00 12 00 26 00 3A 00 48 00 57 00 62 00 89 00 A9 00 E6 01 07 01 38 01 5C 01 5D 01 7A 01 99 01 A5 01 B1 01 B7 01 BD 01 BE 01 C0 01 C1 01 C2 01 C3 01 C4 01 C5 01 C5
			39 01 00 00 00 00 3D D2 00 00 00 02 00 11 00 35 00 4A 00 5F 00 71 00 80 00 8E 00 B9 00 DF 01 0C 01 35 01 68 01 9B 01 9C 01 C8 01 F8 02 14 02 31 02 41 02 51 02 55 02 59 02 5E 02 62 02 67 02 6C 02 70 02 73
			39 01 00 00 00 00 3D D1 00 00 00 03 00 1F 00 45 00 61 00 77 00 8A 00 9C 00 AB 00 DC 00 FE 01 32 01 57 01 97 01 D1 01 D3 02 15 02 69 02 9F 02 E3 03 0F 03 44 03 54 03 67 03 7A 03 91 03 AA 03 C7 03 EA 03 FF
			39 01 00 00 00 00 3D D6 00 00 00 01 00 06 00 12 00 26 00 3A 00 48 00 57 00 62 00 89 00 A9 00 E6 01 07 01 38 01 5C 01 5D 01 7A 01 99 01 A5 01 B1 01 B7 01 BD 01 BE 01 C0 01 C1 01 C2 01 C3 01 C4 01 C5 01 C5
			39 01 00 00 00 00 3D D5 00 00 00 02 00 11 00 35 00 4A 00 5F 00 71 00 80 00 8E 00 B9 00 DF 01 0C 01 35 01 68 01 9B 01 9C 01 C8 01 F8 02 14 02 31 02 41 02 51 02 55 02 59 02 5E 02 62 02 67 02 6C 02 70 02 73
			39 01 00 00 00 00 3D D4 00 00 00 03 00 1F 00 45 00 61 00 77 00 8A 00 9C 00 AB 00 DC 00 FE 01 32 01 57 01 97 01 D1 01 D3 02 15 02 69 02 9F 02 E3 03 0F 03 44 03 54 03 67 03 7A 03 91 03 AA 03 C7 03 EA 03 FF
			39 01 00 00 00 00 06 F0 46 23 11 00 01
		];
		lge,comfort-view-cmds-step9 = [ /* 3000K */
			39 01 00 00 00 00 06 F0 46 23 11 01 01
			39 01 00 00 00 00 05 D0 0F 0F 0F 0F
			39 01 00 00 00 00 3D D3 00 00 00 01 00 09 00 13 00 22 00 36 00 3D 00 46 00 52 00 74 00 8E 00 D4 00 F3 01 1F 01 41 01 42 01 5B 01 6F 01 79 01 82 01 86 01 8A 01 8A 01 8B 01 8C 01 8C 01 8C 01 8C 01 8C 01 8C
			39 01 00 00 00 00 3D D2 00 00 00 06 00 1A 00 39 00 4C 00 5F 00 70 00 7E 00 8B 00 B4 00 D3 01 04 01 28 01 5D 01 8A 01 8C 01 B3 01 DE 01 F4 02 0C 02 19 02 26 02 29 02 2C 02 30 02 33 02 36 02 3A 02 3D 02 3F
			39 01 00 00 00 00 3D D1 00 00 00 09 00 35 00 4F 00 6B 00 7F 00 92 00 A3 00 B0 00 DF 01 01 01 34 01 5A 01 9A 01 D5 01 D7 02 1B 02 70 02 A7 02 EB 03 17 03 4C 03 5C 03 6E 03 81 03 97 03 AF 03 CB 03 EC 03 FF
			39 01 00 00 00 00 3D D6 00 00 00 01 00 09 00 13 00 22 00 36 00 3D 00 46 00 52 00 74 00 8E 00 D4 00 F3 01 1F 01 41 01 42 01 5B 01 6F 01 79 01 82 01 86 01 8A 01 8A 01 8B 01 8C 01 8C 01 8C 01 8C 01 8C 01 8C
			39 01 00 00 00 00 3D D5 00 00 00 06 00 1A 00 39 00 4C 00 5F 00 70 00 7E 00 8B 00 B4 00 D3 01 04 01 28 01 5D 01 8A 01 8C 01 B3 01 DE 01 F4 02 0C 02 19 02 26 02 29 02 2C 02 30 02 33 02 36 02 3A 02 3D 02 3F
			39 01 00 00 00 00 3D D4 00 00 00 09 00 35 00 4F 00 6B 00 7F 00 92 00 A3 00 B0 00 DF 01 01 01 34 01 5A 01 9A 01 D5 01 D7 02 1B 02 70 02 A7 02 EB 03 17 03 4C 03 5C 03 6E 03 81 03 97 03 AF 03 CB 03 EC 03 FF
			39 01 00 00 00 00 06 F0 46 23 11 00 01
		];
		lge,comfort-view-cmds-step10 = [ /* 2500K */
			39 01 00 00 00 00 06 F0 46 23 11 01 01
			39 01 00 00 00 00 05 D0 0F 0F 0F 0F
			39 01 00 00 00 00 3D D3 00 00 00 00 00 02 00 05 00 09 00 0E 00 14 00 1C 00 25 00 40 00 56 00 B8 00 D5 01 00 01 18 01 19 01 19 01 2A 01 2A 01 2A 01 2A 01 2B 01 2B 01 2B 01 2B 01 2C 01 2D 01 2D 01 2D 01 2D
			39 01 00 00 00 00 3D D2 00 00 00 03 00 12 00 32 00 43 00 57 00 64 00 72 00 7F 00 A8 00 C3 00 F7 01 16 01 4E 01 73 01 74 01 9D 01 C0 01 D3 01 E5 01 EE 01 F8 01 FA 01 FD 01 FF 02 02 02 05 02 07 02 0A 02 0B
			39 01 00 00 00 00 3D D1 00 00 00 07 00 34 00 51 00 6B 00 80 00 93 00 A4 00 B1 00 E0 01 03 01 36 01 5C 01 9C 01 D9 01 DB 02 1F 02 74 02 AC 02 F1 03 1D 03 52 03 62 03 74 03 87 03 9B 03 B3 03 CE 03 ED 03 FF
			39 01 00 00 00 00 3D D6 00 00 00 00 00 02 00 05 00 09 00 0E 00 14 00 1C 00 25 00 40 00 56 00 B8 00 D5 01 00 01 18 01 19 01 19 01 2A 01 2A 01 2A 01 2A 01 2B 01 2B 01 2B 01 2C 01 2C 01 2C 01 2D 01 2D 01 2D
			39 01 00 00 00 00 3D D5 00 00 00 03 00 12 00 32 00 43 00 57 00 64 00 72 00 7F 00 A8 00 C3 00 F7 01 16 01 4E 01 73 01 74 01 9D 01 C0 01 D3 01 E5 01 EE 01 F8 01 FA 01 FD 01 FF 02 02 02 05 02 07 02 0A 02 0B
			39 01 00 00 00 00 3D D4 00 00 00 07 00 34 00 51 00 6B 00 80 00 93 00 A4 00 B1 00 E0 01 03 01 36 01 5C 01 9C 01 D9 01 DB 02 1F 02 74 02 AC 02 F1 03 1D 03 52 03 62 03 74 03 87 03 9B 03 B3 03 CE 03 ED 03 FF
			39 01 00 00 00 00 06 F0 46 23 11 00 01
		];

		lge,comfort-view-cmds-state = "dsi_hs_mode";

		qcom,mdss-dsi-on-command-state = "dsi_lp_mode";
		qcom,mdss-dsi-off-command-state = "dsi_hs_mode";
		qcom,mdss-dsi-h-sync-pulse = <1>;//0
		qcom,mdss-dsi-traffic-mode = "non_burst_sync_pulse";
		qcom,mdss-dsi-lane-map = "lane_map_0123";
		qcom,mdss-dsi-bllp-eof-power-mode;
		qcom,suspend-ulps-enabled;
		//qcom,esd-check-enabled;
		qcom,mdss-dsi-panel-status-check-mode = "bta_check";
		qcom,mdss-dsi-last-line-interleave;
		qcom,mdss-dsi-lane-0-state;
		qcom,mdss-dsi-lane-1-state;
		qcom,mdss-dsi-lane-2-state;
		qcom,mdss-dsi-lane-3-state;
		qcom,mdss-dsi-lp11-init;//reset during lp11
		qcom,mdss-dsi-panel-timings = [77 1a 14 00 3e 40 16 1e 15 03 04 00];
		qcom,mdss-dsi-t-clk-post = <0x04>;
		qcom,mdss-dsi-t-clk-pre = <0x1a>;//0x26
		qcom,mdss-dsi-bl-pmic-control-type = "bl_ctrl_wled";
		qcom,mdss-dsi-bl-min-level = <1>;
		qcom,mdss-dsi-bl-max-level = <255>;
		qcom,mdss-dsi-dma-trigger = "trigger_sw";
		qcom,mdss-dsi-mdp-trigger = "none";
		qcom,mdss-dsi-reset-sequence = <2 2>, <0 1>, <2 20>;

                lge,blmap-size = <256>;
                lge,blmap = <
                        0 42 42 42 42 42 42 42 42 42                            /* 0 ~ 9 */
                        42 42 42 43 43 44 44 45 45 46                           /* 10 ~ 19 */
                        46 46 47 47 47 49 51 53 55 57                           /* 20 ~ 29 */
                        59 61 62 63 65 65 65 68 72 75                           /* 30 ~ 39 */
                        79 82 86 89 93 96 99 99 99 105                           /* 40 ~ 49 */
                        110 115 120 125 130 135 140 145 149 149                    /* 50 ~ 59 */
                        149 155 162 168 175 182 188 195 202 206                 /* 60 ~ 69 */
                        210 215 215 215 223 231 239 248 257 266                 /* 70 ~ 79 */
                        275 282 290 300 300 300 310 320 330 340                 /* 80 ~ 89 */
                        350 360 370 380 390 412 424 436 447 460                 /* 90 ~ 99 */
                        472 484 496 503 510 515 520 524 524 524                 /* 100 ~ 109 */
                        536 548 560 572 584 596 608 620 632 644                 /* 110 ~ 119 */
                        666 666 666 682 698 714 730 746 762 778                 /* 120 ~ 129 */
                        794 810 828 828 828 846 862 878 896 914                 /* 130 ~ 139 */
                        930 950 970 992 1013 1013 1013 1033 1053 1075            /* 140 ~ 149 */
                        1096 1117 1140 1160 1180 1200 1219 1219 1219 1242       /* 150 ~ 159 */
                        1265 1283 1306 1329 1352 1375 1399 1410 1425 1449       /* 160 ~ 169 */
                        1449 1449 1475 1501 1527 1553 1579 1605 1631 1658       /* 170 ~ 179 */
                        1680 1703 1703 1703 1731 1759 1788 1808 1836 1852       /* 180 ~ 189 */
                        1890 1918 1950 1983 1983 1983 2014 2044 2073 2103       /* 190 ~ 199 */
                        2133 2166 2193 2223 2263 2292 2292 2292 2328 2354       /* 200 ~ 209 */
                        2390 2426 2450 2486 2522 2558 2594 2601 2629 2629       /* 210 ~ 219 */
                        2629 2665 2701 2737 2773 2809 2845 2881 2917 2953       /* 220 ~ 229 */
                        2990 2990 2990 3030 3070 3110 3150 3190 3240 3280       /* 230 ~ 239 */
                        3320 3350 3380 3380 3380 3422 3464 3506 3548 3590       /* 240 ~ 249 */
                        3630 3670 3710 3750 3775 3800>;
	};
};
