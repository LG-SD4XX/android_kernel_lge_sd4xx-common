/*
 * Copyright (c) 2016, The Linux Foundation. All rights reserved.
 *
 * This program is free software; you can redistribute it and/or modify
 * it under the terms of the GNU General Public License version 2 and
 * only version 2 as published by the Free Software Foundation.
 *
 * This program is distributed in the hope that it will be useful,
 * but WITHOUT ANY WARRANTY; without even the implied warranty of
 * MERCHANTABILITY or FITNESS FOR A PARTICULAR PURPOSE.  See the
 * GNU General Public License for more details.
 */

#include "msm8917-cv3_lgu_kr-pinctrl.dtsi"
#include "msm8917-cv3_lgu_kr-camera.dtsi"
#include "msm8917-cv3_lgu_kr-panel.dtsi"
#include "msm8917-cv3_lgu_kr-sound.dtsi"
#include "msm8917-cv3_lgu_kr-misc.dtsi"
#include "msm8917-cv3_lgu_kr-pm.dtsi"
#include "msm8917-cv3_lgu_kr-nfc.dtsi"
#include "msm8917-cv3_lgu_kr-touch.dtsi"
#include "msm8917-cv3_lgu_kr-fingerprint.dtsi"


&soc {
        i2c_2: i2c@78b6000 { /* BLSP1 QUP2 */
                pericom-type-c@1d {
                                status = "disabled";
                };
        };
};
