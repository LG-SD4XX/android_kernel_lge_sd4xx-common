/* Copyright (c) 2013, The Linux Foundation. All rights reserved.
 *
 * This program is free software; you can redistribute it and/or modify
 * it under the terms of the GNU General Public License version 2 and
 * only version 2 as published by the Free Software Foundation.
 *
 * This program is distributed in the hope that it will be useful,
 * but WITHOUT ANY WARRANTY; without even the implied warranty of
 * MERCHANTABILITY or FITNESS FOR A PARTICULAR PURPOSE.  See the
 * GNU General Public License for more details.
 */

/*---------------------------------------------------------------------------
 * This file is autogenerated file using gcdb parser. Please do not edit it.
 * Update input XML file to add a new entry or update variable in this file
 * VERSION = "1.0"
 *---------------------------------------------------------------------------*/
&mdss_mdp {
	dsi_tvs_lg4894_hd_video: qcom,mdss_dsi_cv3_tovis_lg4894_hd_video {
		compatible = "qcom,mdss-dsi-panel";
		status = "ok";
		qcom,cont-splash-enabled;
		qcom,mdss-dsi-panel-name = "TOVIS LG4894 HD video mode dsi panel";
		qcom,mdss-dsi-panel-controller = <&mdss_dsi0>;
		qcom,mdss-dsi-panel-type = "dsi_video_mode";
		qcom,mdss-dsi-panel-destination = "display_1";
		qcom,mdss-dsi-force-clock-lane-hs;
		qcom,mdss-dsi-panel-framerate = <60>;
		qcom,mdss-dsi-virtual-channel-id = <0>;
		qcom,mdss-dsi-stream = <0>;
		qcom,mdss-dsi-lp11-init;
		qcom,suspend-ulps-enabled;

		qcom,esd-check-enabled;
		qcom,mdss-dsi-panel-status-check-mode = "reg_read";
		qcom,mdss-dsi-panel-status-command = [06 01 00 00 00 00 02 0A 00];
		qcom,mdss-dsi-panel-status-command-state = "dsi_lp_mode";
		qcom,mdss-dsi-panel-status-read-length = <1>;
		qcom,mdss-dsi-panel-status-value = <0x9C>;

		qcom,mdss-dsi-tx-eot-append;
		qcom,mdss-dsi-panel-width = <720>;
		qcom,mdss-dsi-panel-height = <1280>;
		qcom,mdss-dsi-h-front-porch = <4>;
		qcom,mdss-dsi-h-back-porch = <140>;
		qcom,mdss-dsi-h-pulse-width = <2>;
		qcom,mdss-dsi-h-sync-skew = <0>;
		qcom,mdss-dsi-v-front-porch = <180>;
		qcom,mdss-dsi-v-back-porch = <180>;
		qcom,mdss-dsi-v-pulse-width = <1>;
		qcom,mdss-dsi-h-left-border = <0>;
		qcom,mdss-dsi-h-right-border = <0>;
		qcom,mdss-dsi-v-top-border = <0>;
		qcom,mdss-dsi-v-bottom-border = <0>;
		qcom,mdss-pan-physical-width-dimension = < 66 >; // 65.98mm
		qcom,mdss-pan-physical-height-dimension = < 117 >; // 117.31 mm
		qcom,mdss-dsi-bpp = <24>;
		qcom,mdss-dsi-color-order = "rgb_swap_rgb";
		qcom,mdss-dsi-underflow-color = <0xff>;
		qcom,mdss-dsi-border-color = <0>;
		qcom,mdss-dsi-on-command = [
			/* Manufacturer Command Protection */
			15 01 00 00 00 00 02 B0 AC
			/* Display Control 1 */
			39 01 00 00 00 00 05 B1 42 30 16 00
			/* Display Control 2 */
			39 01 00 00 00 00 0D B2 09 00 21 20 B8 00 AE B8 01 01 01 01
			/* Panel Setting */
			39 01 00 00 00 00 04 B4 00 9F 00
			/* MIPI DSI Configuration */
			39 01 00 00 00 00 06 B5 42 C0 80 10 00
			/* MIPI D-PHY Configuration */
			39 01 00 00 00 00 04 B6 77 14 48
			/* Touch Control */
			39 01 00 00 00 00 0A BD D0 02 55 01 04 04 12 20 22
			/* LFD Control */
			39 01 00 00 00 00 08 BE E0 E0 C9 C9 C8 F8 00
			/* Internal Oscillator Setting */
			39 01 00 00 00 00 04 C0 00 B5 B5
			/* Power Control 1 */
			39 01 00 00 00 00 07 C1 01 E8 D8 C2 C1 00
			/* Power Control 2 */
			39 01 00 00 00 00 04 C2 3B 13 13
			/* Power Control 3 */
			39 01 00 00 00 00 07 C3 15 2F 2F 00 66 61
			/* Power Control 4 */
			39 01 00 00 00 00 04 C4 51 00 4C
			/* Power Control 5 */
			39 01 00 00 00 00 06 C5 25 20 20 0C 12
			/* Temp Control */
			39 01 00 00 00 00 0D C7 10 22 00 28 00 45 45 45 00 AA 01 00
			/* Power Sequence Option Configuration */
			39 01 00 00 00 00 05 C8 01 00 03 8C
			/* Power Control for Touch */
			39 01 00 00 00 00 0F CC 20 2F 11 26 21 24 02 4C 4C 4C 00 5C 01 00
			/* Positive Gamma Curve for Red */
			39 01 00 00 00 00 0D D0 50 45 26 54 13 72 00 00 00 70 74 03
			/* Negative Gamma Curve for Red */
			39 01 00 00 00 00 0D D1 50 45 26 54 13 72 00 00 00 70 74 03
			/* Positive Gamma Curve for Green */
			39 01 00 00 00 00 0D D2 50 45 26 54 13 72 00 00 00 70 74 03
			/* Negative Gamma Curve for Green */
			39 01 00 00 00 00 0D D3 50 45 26 54 13 72 00 00 00 70 74 03
			/* Positive Gamma Curve for Blue */
			39 01 00 00 00 00 0D D4 50 45 26 54 13 72 02 02 00 70 74 03
			/* Negative Gamma Curve for Blue */
			39 01 00 00 00 00 0D D5 50 45 26 54 13 72 02 02 00 70 74 03
			/*MIE*/
			15 01 00 00 00 00 02 55 80
			15 01 00 00 00 00 02 ED 50
			39 01 00 00 00 00 06 F1 00 50 90 D0 FF
			39 01 00 00 00 00 07 F2 55 00 40 80 C0 FF
			/* GIP Pad Setting 1 */
			39 01 00 00 00 00 16 E4 4F 4F 4F 4F C3 C1 C9 CA CB CC 4F C2 C0 C7 C8 4F 4F 4F 4F 4F 4F
			/* GIP Pad Setting 2 */
			39 01 00 00 00 00 0D E5 FF FF FF FF FF 13 EF FF FF FF FF 03
			/* Sleep Out */
			05 01 00 00 82 00 01 11
			/* Display On */
			05 01 00 00 14 00 01 29
		];
		qcom,mdss-dsi-off-command = [
			/* Display Off */
			05 01 00 00 64 00 01 28
			/* Sleep In */
			05 01 00 00 5A 00 01 10
		];

		lge,comfort-view-cmds-off = [		// NORMAL
			15 01 00 00 00 00 02 55 80
			15 01 00 00 00 00 02 ED 50
		];

		lge,comfort-view-cmds-step1 = [ /* 7000K */
			15 01 00 00 00 00 02 55 80
			15 01 00 00 00 00 02 ED 54
			39 01 00 00 00 00 11 F5 3F 3F 3F 3F 3F 3F 3F 3F 00 00 00 00 00 00 00 00
			39 01 00 00 00 00 11 F6 3F 3F 3F 3F 3F 3F 3F 3F 00 00 00 00 00 00 00 00
			39 01 00 00 00 00 11 F7 38 38 38 38 38 38 38 38 00 00 00 00 00 00 00 00
		];
		lge,comfort-view-cmds-step2 = [ /* 6500K */
			15 01 00 00 00 00 02 55 80
			15 01 00 00 00 00 02 ED 54
			39 01 00 00 00 00 11 F5 3F 3F 3F 3F 3F 3F 3F 3F 00 00 00 00 00 00 00 00
			39 01 00 00 00 00 11 F6 3E 3E 3E 3E 3E 3E 3E 3E 00 00 00 00 00 00 00 00
			39 01 00 00 00 00 11 F7 35 35 35 35 35 35 35 35 00 00 00 00 00 00 00 00
		];
		lge,comfort-view-cmds-step3 = [ /* 6000K */
			15 01 00 00 00 00 02 55 80
			15 01 00 00 00 00 02 ED 54
			39 01 00 00 00 00 11 F5 3E 3E 3E 3E 3E 3E 3E 3E 00 00 00 00 00 00 00 00
			39 01 00 00 00 00 11 F6 3D 3D 3D 3D 3D 3D 3D 3D 00 00 00 00 00 00 00 00
			39 01 00 00 00 00 11 F7 31 31 31 31 31 31 31 31 00 00 00 00 00 00 00 00
		];

		lge,comfort-view-cmds-step4 = [ /* 5500K */
			15 01 00 00 00 00 02 55 80
			15 01 00 00 00 00 02 ED 54
			39 01 00 00 00 00 11 F5 3D 3D 3D 3D 3D 3D 3D 3D 00 00 00 00 00 00 00 00
			39 01 00 00 00 00 11 F6 3D 3D 3D 3D 3D 3D 3D 3D 00 00 00 00 00 00 00 00
			39 01 00 00 00 00 11 F7 2D 2D 2D 2D 2D 2D 2D 2D 00 00 00 00 00 00 00 00
		];
		lge,comfort-view-cmds-step5 = [ /* 5000K */
			15 01 00 00 00 00 02 55 80
			15 01 00 00 00 00 02 ED 54
			39 01 00 00 00 00 11 F5 3D 3D 3D 3D 3D 3D 3D 3D 00 00 00 00 00 00 00 00
			39 01 00 00 00 00 11 F6 3C 3C 3C 3C 3C 3C 3C 3C 00 00 00 00 00 00 00 00
			39 01 00 00 00 00 11 F7 28 28 28 28 28 28 28 28 00 00 00 00 00 00 00 00
		];
		lge,comfort-view-cmds-step6 = [ /* 4500K */
			15 01 00 00 00 00 02 55 80
			15 01 00 00 00 00 02 ED 54
			39 01 00 00 00 00 11 F5 3D 3D 3D 3D 3D 3D 3D 3D 00 00 00 00 00 00 00 00
			39 01 00 00 00 00 11 F6 3B 3B 3B 3B 3B 3B 3B 3B 00 00 00 00 00 00 00 00
			39 01 00 00 00 00 11 F7 22 22 22 22 22 22 22 22 00 00 00 00 00 00 00 00
		];
		lge,comfort-view-cmds-step7 = [ /* 4000K */
			15 01 00 00 00 00 02 55 80
			15 01 00 00 00 00 02 ED 54
			39 01 00 00 00 00 11 F5 3D 3D 3D 3D 3D 3D 3D 3D 00 00 00 00 00 00 00 00
			39 01 00 00 00 00 11 F6 38 38 38 38 38 38 38 38 00 00 00 00 00 00 00 00
			39 01 00 00 00 00 11 F7 1C 1C 1C 1C 1C 1C 1C 1C 00 00 00 00 00 00 00 00
		];
		lge,comfort-view-cmds-step8 = [ /* 3500K */
			15 01 00 00 00 00 02 55 80
			15 01 00 00 00 00 02 ED 54
			39 01 00 00 00 00 11 F5 3D 3D 3D 3D 3D 3D 3D 3D 00 00 00 00 00 00 00 00
			39 01 00 00 00 00 11 F6 35 35 35 35 35 35 35 35 00 00 00 00 00 00 00 00
			39 01 00 00 00 00 11 F7 14 14 14 14 14 14 14 14 00 00 00 00 00 00 00 00
		];
		lge,comfort-view-cmds-step9 = [ /* 3000K */
			15 01 00 00 00 00 02 55 80
			15 01 00 00 00 00 02 ED 54
			39 01 00 00 00 00 11 F5 3D 3D 3D 3D 3D 3D 3D 3D 00 00 00 00 00 00 00 00
			39 01 00 00 00 00 11 F6 30 30 30 30 30 30 30 30 00 00 00 00 00 00 00 00
			39 01 00 00 00 00 11 F7 09 09 09 09 09 09 09 09 00 00 00 00 00 00 00 00
		];

		lge,comfort-view-cmds-step10 = [ /* 2500K */
			15 01 00 00 00 00 02 55 80
			15 01 00 00 00 00 02 ED 54
			39 01 00 00 00 00 11 F5 3D 3D 3D 3D 3D 3D 3D 3D 00 00 00 00 00 00 00 00
			39 01 00 00 00 00 11 F6 29 29 29 29 29 29 29 29 00 00 00 00 00 00 00 00
			39 01 00 00 00 00 11 F7 00 00 00 00 00 00 00 00 00 00 00 00 00 00 00 00
		];

		lge,comfort-view-cmds-state = "dsi_hs_mode";

		qcom,mdss-dsi-on-command-state = "dsi_lp_mode";
		qcom,mdss-dsi-off-command-state = "dsi_hs_mode";
		qcom,mdss-dsi-reader-mode-command-state = "dsi_hs_mode";
		qcom,mdss-dsi-h-sync-pulse = <0>;
		qcom,mdss-dsi-traffic-mode = "non_burst_sync_event";
		qcom,mdss-dsi-lane-map = "lane_map_0123";
		qcom,mdss-dsi-bllp-eof-power-mode;
		qcom,mdss-dsi-bllp-power-mode;
		qcom,mdss-dsi-last-line-interleave;
		qcom,mdss-dsi-lane-0-state;
		qcom,mdss-dsi-lane-1-state;
		qcom,mdss-dsi-lane-2-state;
		qcom,mdss-dsi-lane-3-state;
		qcom,mdss-dsi-panel-timings = [94 20 14 00 46 4A 1A 24 18 03 04 00];
		qcom,mdss-dsi-t-clk-post = <0x04>;
		qcom,mdss-dsi-t-clk-pre = <0x1D>;
		qcom,mdss-dsi-bl-min-level = <1>;
		qcom,mdss-dsi-bl-max-level = <255>;
		qcom,mdss-dsi-dma-trigger = "trigger_sw";
		qcom,mdss-dsi-mdp-trigger = "none";
		qcom,mdss-dsi-reset-sequence = <1 0>, <0 1>, <1 5>;

		lge,pre-bl-on-delay = <40>;
		lge,mdss-dsi-extra-command-names = "touch-osc-on", "touch-osc-off";
		lge,mdss-dsi-extra-command-touch-osc-on = [
			15 01 00 00 01 00 02 BF 20
			15 01 00 00 01 00 02 BF 60
		];
		lge,mdss-dsi-extra-command-touch-osc-off = [
			15 01 00 00 01 00 02 BF 20
			15 01 00 00 01 00 02 BF 00
		];
		lge,mdss-dsi-extra-command-state-touch-osc-on = "dsi_lp_mode";
		lge,mdss-dsi-extra-command-state-touch-osc-off = "dsi_lp_mode";

		lge,blmap-size = <256>;
		lge,blmap = <
			0 40 40 40 40 40 40 40 40 40
			40 42 44 46 48 50 53 55 57 59
			61 63 65 67 69 71 73 75 78 80
			82 84 86 88 90 92 94 96 98 100
			103 105 107 109 111 113 115 117 119 121
			123 125 128 130 132 134 136 138 140 140
			140 140 140 148 156 165 173 181 189 197
			205 214 222 230 238 246 255 263 271 279
			287 295 304 312 320 328 336 345 353 361
			369 377 385 394 402 410 418 426 435 443
			451 459 467 475 484 492 500 500 500 500
			500 500 516 532 548 564 580 595 611 627
			643 659 675 691 707 723 739 755 770 786
			802 818 834 850 866 882 898 914 930 945
			961 977 993 1009 1025 1041 1057 1073 1089 1105
			1120 1136 1152 1168 1184 1200 1200 1200 1200 1200
			1200 1200 1225 1251 1276 1301 1327 1352 1377 1403
			1428 1453 1479 1504 1530 1555 1580 1606 1631 1656
			1682 1707 1732 1758 1783 1808 1834 1859 1884 1910
			1935 1960 1986 2011 2037 2062 2087 2113 2138 2163
			2189 2214 2239 2265 2290 2290 2290 2290 2290 2290
			2290 2324 2357 2391 2424 2458 2491 2525 2558 2592
			2626 2659 2693 2726 2760 2793 2827 2860 2894 2928
			2961 2995 3028 3062 3095 3129 3162 3196 3230 3263
			3297 3330 3364 3397 3431 3464 3498 3532 3565 3599
			3632 3666 3699 3733 3766 3800>;
	};
};
