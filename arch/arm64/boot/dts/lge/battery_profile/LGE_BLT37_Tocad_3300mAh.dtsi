qcom,LGE_BLT37_Tocad_3300mAh {
	/* #3235236_LGE_BLT37tocad_3300mAh_averaged_MasterSlave_Dec20th2017*/
	qcom,max-voltage-uv = <4400000>;
	qcom,nom-batt-capacity-mah = <3300>;
	qcom,batt-id-kohm = <54000>;
	qcom,battery-beta = <4150>;
	qcom,battery-type = "LGE_BLT37_Tocad_3300mAh";
	qcom,chg-rslow-comp-c1 = <3702733>;
	qcom,chg-rslow-comp-c2 = <6132257>;
	qcom,chg-rs-to-rslow = <937539>;
	qcom,chg-rslow-comp-thr = <0xB2>;
	qcom,checksum = <0xB4F5>;
	qcom,gui-version = "PMI8950GUI - 2.0.0.16";
	qcom,fg-profile-data = [
		 C9 83 5B 77
		 06 80 E0 74
		 38 83 BE 73
		 58 84 F7 80
		 01 82 51 9B
		 E3 BE 70 D0
		 73 10 F4 83
		 DE 7C E5 80
		 A3 76 34 83
		 B4 79 84 87
		 08 88 24 82
		 A5 9B 31 C4
		 5B D2 6D 0E
		 AA 0C BE 5A
		 14 70 29 FC
		 57 22 92 45
		 CB 31 00 00
		 48 4D 3B 3B
		 5B 41 00 00
		 00 00 00 00
		 00 00 00 00
		 ED 6B 6E 6A
		 6D 87 50 80
		 62 77 E3 6B
		 CC 74 66 78
		 20 75 33 68
		 B4 64 64 A8
		 23 D6 62 D9
		 64 A0 71 0C
		 28 00 FF 36
		 F0 11 30 03
		 00 00 00 0C
	];
};
