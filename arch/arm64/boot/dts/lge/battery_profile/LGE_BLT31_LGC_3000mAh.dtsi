
qcom,LGE_BLT31_LGC_3000mAh {
	/* #2794765_LGE_BLT31lgc_3000mAh_averaged_MasterSlave_Feb15th2017*/
	qcom,max-voltage-uv = <4400000>;
	qcom,nom-batt-capacity-mah = <3000>;
	qcom,batt-id-kohm = <5>;
	qcom,battery-beta = <4150>;
	qcom,battery-type = "LGE_BLT31_LGC_3000mAh";
	qcom,chg-rslow-comp-c1 = <2985935>;
	qcom,chg-rslow-comp-c2 = <3956727>;
	qcom,chg-rs-to-rslow = <1093672>;
	qcom,chg-rslow-comp-thr = <0x9F>;
	qcom,checksum = <0xCC3A>;
	qcom,gui-version = "PMI8950GUI - 2.0.0.16";
	qcom,fg-profile-data = [
		 B1 83 0A 75
		 50 79 A7 65
		 64 83 25 75
		 9C 8A 06 96
		 4A 82 9E 98
		 32 B6 3A C1
		 4C 0F A1 82
		 D1 7A 62 7F
		 CD 78 38 83
		 47 79 5D 86
		 D9 81 64 82
		 B4 98 81 B7
		 0D C8 77 13
		 23 0C DB 5A
		 14 70 29 FC
		 30 3D 64 44
		 0B 40 00 00
		 9A 4C FC 33
		 07 41 00 00
		 00 00 00 00
		 00 00 00 00
		 95 70 A1 6B
		 C4 67 36 81
		 9A 76 02 69
		 1C 5D 24 7B
		 C8 75 DD 63
		 F6 74 D8 B2
		 1E 3F 68 49
		 65 A0 71 0C
		 28 00 FF 36
		 F0 11 30 03
		 00 00 00 0C
	];
};
