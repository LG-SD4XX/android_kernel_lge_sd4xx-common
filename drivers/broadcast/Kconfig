## drivers/broadcast/Kconfig
```kconfig
# LGE Broadcast Device Driver Support

menu "LGE Broadcast Device Support"


config LGE_BROADCAST_TDMB
    bool "LGE broadcast TDMB device Driver"
    depends on (MACH_LGE)
    default n
    help
      Select this if you want to use TDMB broadcast service

config LGE_BROADCAST_SBTVD_LATIN
    bool "1Seg Broadcast service"
    depends on (ARCH_MSM8940)
    default n
    help
      Select this if you want to use Latin 1Seg mobile broadcast service

config LGE_BROADCAST_ISDBT_JAPAN
    bool "Japan full-seg Broadcast service"
    depends on (ARCH_MSM8940|| ARCH_MSM8937)
    default n
    help
      Select this if you want to use Japanese FullSeg mobile broadcast service

source "drivers/broadcast/oneseg/Kconfig"
source "drivers/broadcast/tdmb/Kconfig"
endmenu
```

## drivers/nfc/Kconfig
```kconfig
#
# Nxp Nci protocol (I2C) devices
#

#config NFC_PN553_DEVICES
#	bool "Nxp pn553 NCI protocol driver (I2C) devices"
#	default y
#	---help---
#	  You'll have to say Y if your computer contains an I2C device that
#	  you want to use under Linux.
#
#	  You can say N here if you don't have any SPI connected to your computer.

### LGE_START ###

config LGE_NFC
	bool "NFC Device Enabled for LGE"
	default n

config LGE_NFC_PN547_C2
	bool "PN547 C2 NFC driver"
	depends on I2C
	select CRC_CCITT
	default n
	---help---
	  Say yes if you want PN547 Near Field Communication driver.
	  This is for i2c connected version. If unsure, say N here.

	  To compile this driver as a module, choose m here. The module will
	  be called pn547.

config LGE_NFC_PN553
	bool "PN553 NFC driver"
	depends on I2C
	select CRC_CCITT
	default n
	---help---
	  Say yes if you want PN553 Near Field Communication driver.
	  This is for i2c connected version. If unsure, say N here.

	  To compile this driver as a module, choose m here. The module will
	  be called pn553.

config LGE_NFC_SET_IRQ_WAKEUP
	bool "NFC Set IRQ wakeup when NFC ON"
	default n
	---help---
	  Say yes if Set IRQ Wakeup NFC ON.
	  If unsure, say N here.

config LGE_NFC_DEBUG_MESSAGE
	bool "NFC Debug Message"
	default n

config CXD224X_NFC
    tristate "CXD224X NFC driver"
    depends on I2C
    select CRC_CCITT
    default n
    ---help---
      Say yes if you want cxd224x Near Field Communication driver.
      This is for i2c connected version. If unsure, say N here.

      To compile this driver as a module, choose m here. The module will
      be called cxd224x-i2c.

config CXD224X_NFC_VEN
    tristate "CXD224X NFC VEN"
    depends on CXD224X_NFC
    default n
    ---help---
      Say yes if you want to use cxd224x NFC VEN(enable voltage) control.
      If unsure, say N here.

source "drivers/nfc/pn544/Kconfig"
source "drivers/nfc/pn548/Kconfig"
source "drivers/nfc/microread/Kconfig"
source "drivers/nfc/nfcmrvl/Kconfig"
source "drivers/nfc/st21nfca/Kconfig"
source "drivers/nfc/st21nfcb/Kconfig"
```

## drivers/soc/qcom/lge/Kconfig
```kconfig
config MACH_LGE
	bool "Machine LGE"
	help
	  Support for machine LGE.

menu "LGE Board Selection"

config MACH_MSM8937_PH2N_GSM_US
	bool "MSM8937 PH2N_GSM_US"
	depends on ARCH_MSM8916
	select MACH_LGE
	help
	  Support for the Qualcomm MSM8937 PH2N_GSM_US devices (TMO/MPCS).

config MACH_MSM8917_LV517_GSM_US
	bool "MSM8917 LV517_GSM_US"
	depends on ARCH_MSM8916
	select MACH_LGE
	help
	  Support for the Qualcomm MSM8917 LV517_GSM_US devices (TMO/MPCS).

config MACH_MSM8940_SF3_TMO_US
	bool "MSM8940 SF3_TMO_US"
	depends on ARCH_MSM8916
	select MACH_LGE
	help
	  Support for the Qualcomm MSM8940 SF3_TMO_US device.

config MACH_MSM8917_CV1_LAO_COM
        bool "MSM8917 CV1_LAO_COM"
        depends on ARCH_MSM8916
        select MACH_LGE
        help
          Support for the Qualcomm MSM8917 CV1_LAO_COM device.

endmenu

menu "LGE Specific Patches"

config LGE_HANDLE_PANIC
	tristate "Support LGE Crash Handler"
	default n
	depends on MACH_LGE
	help
	  LGE Crash Handler

config LGE_QSDL_SUPPORT
	tristate "Support for Quality Statistics Data Logging"
	default n
	depends on MACH_LGE
	help
	  QSDL is a feature which notify infomation for quality statistics data logging of device.
	  
config LGE_BOOTLOADER_LOG
	tristate "Support LGE bootloader log"
	default n
	depends on MACH_LGE
	help
	  LGE bootloader log

config LGE_BOOT_LOCKUP_DETECT
	bool "Support to detect lockup during powering on"
	default n
	depends on LGE_HANDLE_PANIC
	help
	  For detecting lockup in boot , use simple detector which
	  raise crash when expired some period after boot.

config LGE_BOOTLOADER_TIME_CHECKER
	tristate "Supprt bootloader(LK, SBL) time"
	default n
	depends on MACH_LGE
	help
	  Check LK, SBL booting time at
	  sys/module/lge_bootloader_time_checker/parameters/lk_time
	  sys/module/lge_bootloader_time_checker/parameters/sbl_time

config LGE_PM
	tristate "Support LGE power-management"
	default n
	depends on MACH_LGE
	help
	  Global feature of LGE power-management

config LGE_PM_DEBUG
        tristate "Support LGE PM Debug Feature"
        default n
        depends on MACH_LGE
        help
	  LGE PM Debug Feature

config LGE_PM_PSEUDO_BATTERY
	tristate "Support pseudo battery mode"
	depends on MACH_LGE
	default n
	help
	  Say Y here to enable pseudo mode setting

config LGE_PM_CHARGING_TEMP_SCENARIO
tristate "Support LGE PM Charging scenario"
	default n
	depends on MACH_LGE
	help
	  LGE PM Charing Scenario

config LGE_PM_CHARGING_TEMP_SCENARIO_V2
	tristate "Support LGE PM Charging scenario V2"
	default n
	depends on LGE_PM_CHARGING_TEMP_SCENARIO
	help
	  LGE PM Charging Scenario V2

config LGE_UART_CONTROL
	tristate "Support LGE uart control"
	default n
	depends on MACH_LGE && SERIAL_MSM_HSL
	help
	  This module controls uart console.

config LGE_EARJACK_DEBUGGER
	tristate "Earjack UART debugger support"
	default n
	depends on LGE_UART_CONTROL
	help
	  Support earjack type UART debugger cable

config LGE_USE_DEFAULT_HARD_RESET
	bool "On reboot, apply hard reset unless memory contents must be maintained"
	default n
	help
	  Nobody can guarantee stablity upon continuous warm resets.

config LGE_PM_CABLE_DETECTION
    tristate "Support LGE PM Cable Detection"
	default n
	depends on MACH_LGE
	help
	  LGE PM Cable Detection

config LGE_PM_TIME_TO_FULL
    tristate "Support LGE PM Time To Full"
	default n
	depends on LGE_PM
	help
	  LGE PM Time To Full

config LGE_PM_TIME_TO_FULL_AVG_CURRENT
    tristate "Support LGE PM Time To Full Average Current"
	default n
	depends on LGE_PM
	help
	  LGE PM Time To Full Average Current

config LGE_PM_UNIFIED_NODE
	bool "enable LGE PM Unified sysfs node"
	default n
	depends on MACH_LGE
	help
	  Support LGE PM Unified sysfs node

config LGE_PM_ONBINARY_ORANGE
        tristate "Support LGE PM Onebinary orange Detection"
	default n
	depends on LGE_PM
	help
	  LGE PM Onebinary Orange Detection

config LGE_ONE_BINARY_SKU
        tristate "Support LGE One binary sku carrier"
	default n
	depends on MACH_LGE
	help
	  LGE One Binary sku carrier.

config PRE_SELF_DIAGNOSIS
	tristate "Support LGE self diagnosis for factory"
	default n
	depends on MACH_LGE
	help
	  LGE self diagnosis
endmenu

menu "LGE QFPROM Values"

config LGE_QFPROM_INTERFACE
	bool "Support qfprom interface"
	default n
	depends on MACH_LGE
	help
	  LGE QFPROM DRIVER.

config LGE_QFPROM_SECHASH
	string "Support qfprom sec hash"
	default 0x0
	depends on LGE_QFPROM_INTERFACE
	help
	  LGE QFPROM DRIVER-SEC partition's hash value.
endmenu
```
